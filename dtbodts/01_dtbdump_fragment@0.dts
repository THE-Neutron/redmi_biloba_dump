/dts-v1/;

/ {

	__fixups__ {
		accdet = "/fragment@11:target:0";
		auxadc = "/fragment@25:target:0", "/fragment@26/__overlay__:io-channels:0";
		charger = "/fragment@7:target:0";
		chosen = "/fragment@1:target:0";
		consys = "/fragment@15:target:0";
		dsi_te = "/fragment@44:target:0";
		goodix_fp = "/fragment@23:target:0", "/fragment@41:target:0";
		gpio = "/fragment@38:target:0";
		gpio_usage_mapping = "/fragment@37:target:0";
		i2c0 = "/fragment@28:target:0", "/fragment@65:target:0";
		i2c1 = "/fragment@29:target:0";
		i2c2 = "/fragment@8:target:0", "/fragment@30:target:0";
		i2c3 = "/fragment@31:target:0";
		i2c4 = "/fragment@32:target:0";
		i2c5 = "/fragment@33:target:0";
		i2c6 = "/fragment@21:target:0", "/fragment@34:target:0";
		i2c7 = "/fragment@4:target:0", "/fragment@5:target:0", "/fragment@35:target:0";
		i2c8 = "/fragment@36:target:0";
		irtx_pwm = "/fragment@16:target:0";
		kd_camera_hw1 = "/fragment@57:target:0", "/fragment@61:target:0", "/fragment@63:target:0";
		keypad = "/fragment@59:target:0";
		lk_charger = "/fragment@6:target:0";
		main_pmic = "/fragment@47:target:0";
		md1_sim1_hot_plug_eint = "/fragment@48:target:0";
		md1_sim2_hot_plug_eint = "/fragment@49:target:0";
		md_auxadc = "/fragment@26:target:0";
		mrdump_ext_rst = "/fragment@39:target:0";
		mt6370_pmu = "/fragment@12:target:0";
		mt6370_typec = "/fragment@13:target:0";
		mt_charger = "/fragment@3:target:0";
		mt_pmic_vcama1_ldo_reg = "/fragment@50:target:0", "/fragment@57/__overlay__:vcama-supply:0", "/fragment@61/__overlay__:cam0_vcama-supply:0";
		mt_pmic_vcama2_ldo_reg = "/fragment@51:target:0", "/fragment@57/__overlay__:vcama_sub-supply:0", "/fragment@61/__overlay__:cam2_vcama-supply:0", "/fragment@61/__overlay__:cam3_vcama-supply:0", "/fragment@61/__overlay__:cam4_vcama-supply:0";
		mt_pmic_vcamd_ldo_reg = "/fragment@54:target:0", "/fragment@57/__overlay__:vcamd_main2-supply:0", "/fragment@61/__overlay__:cam1_vcamd-supply:0", "/fragment@61/__overlay__:cam2_vcamd-supply:0";
		mt_pmic_vcamio_ldo_reg = "/fragment@55:target:0", "/fragment@57/__overlay__:vcamio-supply:0", "/fragment@57/__overlay__:vcamio_sub-supply:0", "/fragment@57/__overlay__:vcamio_main2-supply:0", "/fragment@61/__overlay__:cam0_vcamio-supply:0", "/fragment@61/__overlay__:cam1_vcamio-supply:0", "/fragment@61/__overlay__:cam2_vcamio-supply:0", "/fragment@61/__overlay__:cam3_vcamio-supply:0", "/fragment@61/__overlay__:cam4_vcamio-supply:0";
		mt_pmic_vldo28_ldo_reg = "/fragment@2/__overlay__/camera_main_af_hw_node:cam0_vcamf-supply:0", "/fragment@2/__overlay__/camera_main3_af_hw_node:cam4_vcamf-supply:0", "/fragment@56:target:0", "/fragment@57/__overlay__:vcamaf-supply:0", "/fragment@57/__overlay__:vcamaf_sub-supply:0", "/fragment@57/__overlay__:vcamaf_main2-supply:0", "/fragment@58/__overlay__:vtouch-supply:0";
		mt_pmic_vsim1_ldo_reg = "/fragment@52:target:0";
		mt_pmic_vsim2_ldo_reg = "/fragment@53:target:0";
		mtkfb = "/fragment@19:target:0";
		odm = "/fragment@2:target:0";
		pio = "/fragment@3/__overlay__:interrupt-parent:0", "/fragment@3/__overlay__:reverse-gpio:0", "/fragment@4/__overlay__/fusb303@21:interrupt-parent:0", "/fragment@4/__overlay__/fusb303@21:fusb303,int-gpio:0", "/fragment@5/__overlay__/smb1351-charger@55:interrupt-parent:0", "/fragment@12/__overlay__:mt6370,intr_gpio:0", "/fragment@13/__overlay__:mt6370pd,intr_gpio:0", "/fragment@13/__overlay__:mt6370pd,usb_switch_gpio:0", "/fragment@14:target:0", "/fragment@17:target:0", "/fragment@18:target:0", "/fragment@20/__overlay__/cs35l41@0:reset-gpio:0", "/fragment@20/__overlay__/cs35l41@0:interrupt-parent:0", "/fragment@20/__overlay__/cs35l41@0:irq-gpio:0", "/fragment@23/__overlay__:fpc,gpio_irq:0", "/fragment@24:target:0", "/fragment@37/__overlay__:GPIO_FDD_BAND_SUPPORT_DETECT_1ST_PIN:0", "/fragment@37/__overlay__:GPIO_FDD_BAND_SUPPORT_DETECT_2ND_PIN:0", "/fragment@37/__overlay__:GPIO_SIM2_HOT_PLUG:0", "/fragment@37/__overlay__:GPIO_SIM1_HOT_PLUG:0", "/fragment@37/__overlay__:GPIO_SIM2_SIO:0", "/fragment@37/__overlay__:GPIO_SIM2_SRST:0", "/fragment@37/__overlay__:GPIO_SIM2_SCLK:0", "/fragment@37/__overlay__:GPIO_SIM1_SCLK:0", "/fragment@37/__overlay__:GPIO_SIM1_SRST:0", "/fragment@37/__overlay__:GPIO_SIM1_SIO:0", "/fragment@39/__overlay__:interrupt-parent:0", "/fragment@39/__overlay__:deb-gpios:0", "/fragment@40/__overlay__:interrupt-parent:0", "/fragment@41/__overlay__:interrupt-parent:0", "/fragment@42/__overlay__:interrupt-parent:0", "/fragment@43/__overlay__:interrupt-parent:0", "/fragment@44/__overlay__:interrupt-parent:0", "/fragment@45/__overlay__:interrupt-parent:0", "/fragment@45/__overlay__:deb-gpios:0", "/fragment@46/__overlay__:interrupt-parent:0", "/fragment@46/__overlay__:deb-gpios:0", "/fragment@47/__overlay__:interrupt-parent:0", "/fragment@60:target:0", "/fragment@62:target:0", "/fragment@64/__overlay__/touch@0:novatek,reset-gpio:0", "/fragment@64/__overlay__/touch@0:novatek,irq-gpio:0", "/fragment@64/__overlay__/touch@0:interrupt-parent:0", "/fragment@64/__overlay__/touch@0:focaltech,reset-gpio:0", "/fragment@64/__overlay__/touch@0:focaltech,irq-gpio:0";
		pmic_clock_buffer_ctrl = "/fragment@27:target:0";
		reserved_memory = "/fragment@0:target:0";
		reverse_high = "/fragment@3/__overlay__:pinctrl-0:0";
		reverse_low = "/fragment@3/__overlay__:pinctrl-1:0";
		spi0 = "/fragment@64:target:0";
		spi1 = "/fragment@9:target:0";
		spi2 = "/fragment@22:target:0";
		spi3 = "/fragment@20:target:0";
		spi5 = "/fragment@10:target:0";
		subpmic_pmu_eint = "/fragment@42:target:0";
		swtp = "/fragment@46:target:0";
		swtp_1 = "/fragment@45:target:0";
		tcpc_pd = "/fragment@43:target:0";
		touch = "/fragment@40:target:0", "/fragment@58:target:0";
	};

	__local_fixups__ {

		fragment@15 {

			__overlay__ {
				pinctrl-0 = <0x0>;
				pinctrl-1 = <0x0>;
				pinctrl-2 = <0x0>;
				pinctrl-3 = <0x0>;
			};
		};

		fragment@16 {

			__overlay__ {
				pinctrl-0 = <0x0>;
				pinctrl-1 = <0x0>;
			};
		};

		fragment@19 {

			__overlay__ {
				pinctrl-0 = <0x0>;
				pinctrl-1 = <0x0>;
				pinctrl-2 = <0x0>;
			};
		};

		fragment@2 {

			__overlay__ {

				flashlights_cust_gpio {
					pinctrl-0 = <0x0>;
					pinctrl-1 = <0x0>;
					pinctrl-2 = <0x0>;
					pinctrl-3 = <0x0>;
				};
			};
		};

		fragment@23 {

			__overlay__ {
				pinctrl-0 = <0x0>;
				pinctrl-1 = <0x0>;
				pinctrl-2 = <0x0>;
			};
		};

		fragment@61 {

			__overlay__ {
				pinctrl-0 = <0x0>;
				pinctrl-1 = <0x0>;
				pinctrl-10 = <0x0>;
				pinctrl-11 = <0x0>;
				pinctrl-12 = <0x0>;
				pinctrl-13 = <0x0>;
				pinctrl-14 = <0x0>;
				pinctrl-15 = <0x0>;
				pinctrl-16 = <0x0>;
				pinctrl-17 = <0x0>;
				pinctrl-18 = <0x0>;
				pinctrl-19 = <0x0>;
				pinctrl-2 = <0x0>;
				pinctrl-20 = <0x0>;
				pinctrl-21 = <0x0>;
				pinctrl-22 = <0x0>;
				pinctrl-23 = <0x0>;
				pinctrl-24 = <0x0>;
				pinctrl-25 = <0x0>;
				pinctrl-26 = <0x0>;
				pinctrl-27 = <0x0>;
				pinctrl-28 = <0x0>;
				pinctrl-29 = <0x0>;
				pinctrl-3 = <0x0>;
				pinctrl-30 = <0x0>;
				pinctrl-31 = <0x0>;
				pinctrl-32 = <0x0>;
				pinctrl-33 = <0x0>;
				pinctrl-34 = <0x0>;
				pinctrl-35 = <0x0>;
				pinctrl-36 = <0x0>;
				pinctrl-37 = <0x0>;
				pinctrl-38 = <0x0>;
				pinctrl-39 = <0x0>;
				pinctrl-4 = <0x0>;
				pinctrl-40 = <0x0>;
				pinctrl-41 = <0x0>;
				pinctrl-42 = <0x0>;
				pinctrl-43 = <0x0>;
				pinctrl-5 = <0x0>;
				pinctrl-6 = <0x0>;
				pinctrl-7 = <0x0>;
				pinctrl-8 = <0x0>;
				pinctrl-9 = <0x0>;
			};
		};
	};

	__symbols__ {
		camera0_mclk_2mA = "/fragment@60/__overlay__/camera0_mclk_2mA@gpio100";
		camera0_mclk_4mA = "/fragment@60/__overlay__/camera0_mclk_4mA@gpio100";
		camera0_mclk_6mA = "/fragment@60/__overlay__/camera0_mclk_6mA@gpio100";
		camera0_mclk_8mA = "/fragment@60/__overlay__/camera0_mclk_8mA@gpio100";
		camera0_mclk_off = "/fragment@60/__overlay__/camera0_mclk_gpio_mode@gpio100";
		camera0_rst_high = "/fragment@60/__overlay__/camera0_rst_output_high@gpio102";
		camera0_rst_low = "/fragment@60/__overlay__/camera0_rst_output_low@gpio102";
		camera0_vcamd_off = "/fragment@60/__overlay__/camera0_vcamd_output_low@gpio179";
		camera0_vcamd_on = "/fragment@60/__overlay__/camera0_vcamd_output_high@gpio179";
		camera1_mclk_2mA = "/fragment@60/__overlay__/camera1_mclk_2mA@gpio108";
		camera1_mclk_4mA = "/fragment@60/__overlay__/camera1_mclk_4mA@gpio108";
		camera1_mclk_6mA = "/fragment@60/__overlay__/camera1_mclk_6mA@gpio108";
		camera1_mclk_8mA = "/fragment@60/__overlay__/camera1_mclk_8mA@gpio108";
		camera1_mclk_off = "/fragment@60/__overlay__/camera1_mclk_gpio_mode@gpio108";
		camera1_rst_high = "/fragment@60/__overlay__/camera1_rst_output_high@gpio109";
		camera1_rst_low = "/fragment@60/__overlay__/camera1_rst_output_low@gpio109";
		camera1_vcama_off = "/fragment@60/__overlay__/camera1_vcama_output_low@gpio178";
		camera1_vcama_on = "/fragment@60/__overlay__/camera1_vcama_output_high@gpio178";
		camera2_mclk_2mA = "/fragment@60/__overlay__/camera2_mclk_2mA@gpio108";
		camera2_mclk_4mA = "/fragment@60/__overlay__/camera2_mclk_4mA@gpio108";
		camera2_mclk_6mA = "/fragment@60/__overlay__/camera2_mclk_6mA@gpio108";
		camera2_mclk_8mA = "/fragment@60/__overlay__/camera2_mclk_8mA@gpio108";
		camera2_mclk_off = "/fragment@60/__overlay__/camera2_mclk_gpio_mode@gpio108";
		camera2_mipisel_off = "/fragment@60/__overlay__/camera2_mipisel_off@gpio4";
		camera2_mipisel_on = "/fragment@60/__overlay__/camera2_mipisel_on@gpio4";
		camera2_rst_high = "/fragment@60/__overlay__/camera2_rst_output_high@gpio7";
		camera2_rst_low = "/fragment@60/__overlay__/camera2_rst_output_low@gpio7";
		camera3_mclk_2mA = "/fragment@60/__overlay__/camera3_mclk_2mA@gpio99";
		camera3_mclk_4mA = "/fragment@60/__overlay__/camera3_mclk_4mA@gpio99";
		camera3_mclk_6mA = "/fragment@60/__overlay__/camera3_mclk_6mA@gpio99";
		camera3_mclk_8mA = "/fragment@60/__overlay__/camera3_mclk_8mA@gpio99";
		camera3_mclk_off = "/fragment@60/__overlay__/camera3_mclk_gpio_mode@gpio99";
		camera3_pdn_high = "/fragment@60/__overlay__/camera3_pdn_output_high@gpio17";
		camera3_pdn_low = "/fragment@60/__overlay__/camera3_pdn_output_low@gpio17";
		camera3_rst_high = "/fragment@60/__overlay__/camera3_rst_output_high@gpio101";
		camera3_rst_low = "/fragment@60/__overlay__/camera3_rst_output_low@gpio101";
		camera4_mclk_2mA = "/fragment@60/__overlay__/camera4_mclk_2mA@gpio111";
		camera4_mclk_4mA = "/fragment@60/__overlay__/camera4_mclk_4mA@gpio111";
		camera4_mclk_6mA = "/fragment@60/__overlay__/camera4_mclk_6mA@gpio111";
		camera4_mclk_8mA = "/fragment@60/__overlay__/camera4_mclk_8mA@gpio111";
		camera4_mclk_off = "/fragment@60/__overlay__/camera4_mclk_gpio_mode@gpio111";
		camera4_rst_high = "/fragment@60/__overlay__/camera4_rst_output_high@gpio112";
		camera4_rst_low = "/fragment@60/__overlay__/camera4_rst_output_low@gpio112";
		camera_main3_af_hw_node = "/fragment@2/__overlay__/camera_main3_af_hw_node";
		camera_main3_af_node = "/fragment@2/__overlay__/camera_main3_af_node";
		camera_main_af_hw_node = "/fragment@2/__overlay__/camera_main_af_hw_node";
		camera_main_af_mtk = "/fragment@30/__overlay__/camera_main_af@18";
		camera_main_af_node = "/fragment@2/__overlay__/camera_main_af_node";
		camera_main_eeprom_mtk = "/fragment@30/__overlay__/camera_main_eeprom@52";
		camera_main_mtk = "/fragment@30/__overlay__/camera_main@5a";
		camera_main_three_af_mtk = "/fragment@32/__overlay__/camera_main_three_af@18";
		camera_main_three_eeprom_mtk = "/fragment@32/__overlay__/camera_main_three_eeprom@51";
		camera_main_three_mtk = "/fragment@32/__overlay__/camera_main_three@2e";
		camera_main_two_eeprom_mtk = "/fragment@30/__overlay__/camera_main_two_eeprom@54";
		camera_main_two_mtk = "/fragment@30/__overlay__/camera_main_two@20";
		camera_pins_default = "/fragment@60/__overlay__/camdefault";
		camera_sub_eeprom_mtk = "/fragment@32/__overlay__/camera_sub_eeprom@50";
		camera_sub_mtk = "/fragment@32/__overlay__/camera_sub@6c";
		camera_sub_two_eeprom_mtk = "/fragment@32/__overlay__/camera_sub_two_eeprom@37";
		camera_sub_two_mtk = "/fragment@32/__overlay__/camera_sub_two@6e";
		ccu_sensor_i2c_2_hw_mtk = "/fragment@30/__overlay__/ccu_sensor_i2c_2_hw@11";
		ccu_sensor_i2c_4_hw_mtk = "/fragment@32/__overlay__/ccu_sensor_i2c_4_hw@12";
		consys_pins_default = "/fragment@14/__overlay__/consys_default";
		fingerprint_default = "/fragment@24/__overlay__/state_default";
		fingerprint_reset_high = "/fragment@24/__overlay__/state_reset_high";
		fingerprint_reset_low = "/fragment@24/__overlay__/state_reset_low";
		flashlights_cust_gpio = "/fragment@2/__overlay__/flashlights_cust_gpio";
		flashlights_cust_pins_en_high = "/fragment@62/__overlay__/flashlights_cust_pins_en_output_high@gpio152";
		flashlights_cust_pins_en_low = "/fragment@62/__overlay__/flashlights_cust_pins_en_output_low@gpio152";
		flashlights_cust_pins_strobe_high = "/fragment@62/__overlay__/flashlights_cust_pins_strobe_output_high@gpio153";
		flashlights_cust_pins_strobe_low = "/fragment@62/__overlay__/flashlights_cust_pins_strobe_output_low@gpio153";
		gpslna_pins_init = "/fragment@14/__overlay__/gpslna@0";
		gpslna_pins_oh = "/fragment@14/__overlay__/gpslna@1";
		gpslna_pins_ol = "/fragment@14/__overlay__/gpslna@2";
		irtx_gpio_led_default = "/fragment@17/__overlay__/irtx_gpio_led_def@gpio12";
		irtx_gpio_led_set = "/fragment@17/__overlay__/irtx_gpio_led_set@gpio12";
		led0 = "/fragment@2/__overlay__/led@0";
		led1 = "/fragment@2/__overlay__/led@1";
		led2 = "/fragment@2/__overlay__/led@2";
		led3 = "/fragment@2/__overlay__/led@3";
		led4 = "/fragment@2/__overlay__/led@4";
		led5 = "/fragment@2/__overlay__/led@5";
		led6 = "/fragment@2/__overlay__/led@6";
		mtkfb_pins_lcm_dsi_te = "/fragment@18/__overlay__/lcm_dsi_te";
		mtkfb_pins_lcm_rst_out0_gpio = "/fragment@18/__overlay__/lcm_rst_out0_gpio";
		mtkfb_pins_lcm_rst_out1_gpio = "/fragment@18/__overlay__/lcm_rst_out1_gpio";
		nfc_mtk = "/fragment@31/__overlay__/nfc@08";
		smart_pa = "/fragment@20/__overlay__/cs35l41@0";
		smb1351_charger_mtk = "/fragment@35/__overlay__/smb1351_charger@55";
		spidev1 = "/fragment@9/__overlay__/spi@1";
		spidev5 = "/fragment@10/__overlay__/spi@5";
		subpmic_pmu_mtk = "/fragment@33/__overlay__/subpmic_pmu@34";
		usb_type_c_mtk = "/fragment@35/__overlay__/usb_type_c@60";
		vibrator0 = "/fragment@2/__overlay__/vibrator@0";
	};

	fragment@0 {
		target = <0xffffffff>;

		__overlay__ {

			reserve-memory-scp_share {
				alignment = <0x0 0x1000000>;
				alloc-ranges = <0x0 0x40000000 0x0 0x50000000>;
				compatible = "mediatek,reserve-memory-scp_share";
				no-map;
				size = <0x0 0xd00000>;
			};
		};
	};

	fragment@1 {
		target = <0xffffffff>;

		__overlay__ {
			atag,videolfb-fb_base_h = <0x0>;
			atag,videolfb-fb_base_l = "~`P";
			atag,videolfb-fps = <0x1770>;
			atag,videolfb-islcm_inited = <0x0>;
			atag,videolfb-islcmfound = <0x1>;
			atag,videolfb-lcmname = "hx83112b_fhdp_dsi_cmd_auo_rt5081_drv";
			atag,videolfb-vramSize = <0x17e8000>;
		};
	};

	fragment@10 {
		target = <0xffffffff>;

		__overlay__ {
			status = "okay";

			spi@5 {
				compatible = "ir,ir_spi";
				phandle = <0x4b>;
				reg = <0x0>;
				spi-cpol;
				spi-max-frequency = <0xf4240>;
			};
		};
	};

	fragment@11 {
		target = <0xffffffff>;

		__overlay__ {
			accdet-mic-mode = <0x1>;
			accdet-mic-vol = <0x6>;
			accdet-plugout-debounce = <0x1>;
			headset-eint-level-pol = <0x8>;
			headset-four-key-threshold = <0x0 0x3a 0x79 0xc0 0x190>;
			headset-mode-setting = <0x500 0x500 0x1 0x1f0 0x800 0x800 0x20 0x44>;
			headset-three-key-threshold = <0x0 0x50 0xdc 0x190>;
			headset-three-key-threshold-CDD = <0x0 0x79 0xc0 0x258>;
			status = "okay";
		};
	};

	fragment@12 {
		target = <0xffffffff>;

		__overlay__ {
			mt6370,intr_gpio = <0xffffffff 0x14 0x0>;
			mt6370,intr_gpio_num = <0x14>;
		};
	};

	fragment@13 {
		target = <0xffffffff>;

		__overlay__ {
			mt6370pd,intr_gpio = <0xffffffff 0x29 0x0>;
			mt6370pd,intr_gpio_num = <0x29>;
			mt6370pd,usb_switch_gpio = <0xffffffff 0x5b 0x0>;
			mt6370pd,usb_switch_gpio_num = <0x5b>;
		};
	};

	fragment@14 {
		target = <0xffffffff>;

		__overlay__ {

			consys_default {
				phandle = <0x5>;
			};

			gpslna@0 {
				phandle = <0x6>;

				pins_cmd_dat {
					bias-disable;
					output-low;
					pinmux = <0x5e00>;
					slew-rate = <0x0>;
				};
			};

			gpslna@1 {
				phandle = <0x7>;

				pins_cmd_dat {
					output-high;
					pinmux = <0x5e00>;
					slew-rate = <0x1>;
				};
			};

			gpslna@2 {
				phandle = <0x8>;

				pins_cmd_dat {
					output-low;
					pinmux = <0x5e00>;
					slew-rate = <0x1>;
				};
			};
		};
	};

	fragment@15 {
		target = <0xffffffff>;

		__overlay__ {
			pinctrl-0 = <0x5>;
			pinctrl-1 = <0x6>;
			pinctrl-2 = <0x7>;
			pinctrl-3 = <0x8>;
			pinctrl-names = "default", "gps_lna_state_init", "gps_lna_state_oh", "gps_lna_state_ol";
			status = "okay";
		};
	};

	fragment@16 {
		target = <0xffffffff>;

		__overlay__ {
			pinctrl-0 = <0x9>;
			pinctrl-1 = <0xa>;
			pinctrl-names = "irtx_gpio_led_default", "irtx_gpio_led_set";
			status = "okay";
		};
	};

	fragment@17 {
		target = <0xffffffff>;

		__overlay__ {

			irtx_gpio_led_def@gpio12 {
				phandle = <0x9>;

				pins_cmd_dat {
					bias-disable;
					input-schmitt-enable = <0x0>;
					output-low;
					pinmux = <0xc00>;
					slew-rate = <0x1>;
				};
			};

			irtx_gpio_led_set@gpio12 {
				phandle = <0xa>;

				pins_cmd_dat {
					output-high;
					pinmux = <0xc01>;
					slew-rate = <0x1>;
				};
			};
		};
	};

	fragment@18 {
		target = <0xffffffff>;

		__overlay__ {

			lcm_dsi_te {
				phandle = <0xd>;

				pins_cmd_dat {
					pinmux = <0x2c01>;
				};
			};

			lcm_rst_out0_gpio {
				phandle = <0xc>;

				pins_cmd_dat {
					output-low;
					pinmux = <0x2d00>;
					slew-rate = <0x1>;
				};
			};

			lcm_rst_out1_gpio {
				phandle = <0xb>;

				pins_cmd_dat {
					output-high;
					pinmux = <0x2d00>;
					slew-rate = <0x1>;
				};
			};
		};
	};

	fragment@19 {
		target = <0xffffffff>;

		__overlay__ {
			pinctrl-0 = <0xb>;
			pinctrl-1 = <0xc>;
			pinctrl-2 = <0xd>;
			pinctrl-names = "lcm_rst_out1_gpio", "lcm_rst_out0_gpio", "mode_te_te";
			status = "okay";
		};
	};

	fragment@2 {
		target = <0xffffffff>;

		__overlay__ {

			camera_main3_af_hw_node {
				cam4_vcamf-supply = <0xffffffff>;
				compatible = "mediatek,camera3_af_lens";
				phandle = <0x47>;
				status = "okay";
			};

			camera_main3_af_node {
				compatible = "mediatek,CAMERA_MAIN_THREE_AF";
				phandle = <0x48>;
			};

			camera_main_af_hw_node {
				cam0_vcamf-supply = <0xffffffff>;
				compatible = "mediatek,camera_af_lens";
				phandle = <0x45>;
				status = "okay";
			};

			camera_main_af_node {
				compatible = "mediatek,CAMERA_MAIN_AF";
				phandle = <0x46>;
			};

			flashlights_cust_gpio {
				compatible = "mediatek,flashlights_cust_gpio";
				decouple = <0x1>;
				phandle = <0x49>;
				pinctrl-0 = <0x1>;
				pinctrl-1 = <0x2>;
				pinctrl-2 = <0x3>;
				pinctrl-3 = <0x4>;
				pinctrl-names = "flashlights_cust_pins_en_low", "flashlights_cust_pins_en_high", "flashlights_cust_pins_strobe_low", "flashlights_cust_pins_strobe_high";
				status = "okay";

				channel@1 {
					ct = <0x0>;
					part = <0x0>;
					type = <0x0>;
				};
			};

			led@0 {
				compatible = "mediatek,red";
				data = <0x1>;
				led_mode = <0x0>;
				phandle = <0x3d>;
				pwm_config = <0x0 0x0 0x0 0x0 0x0>;
			};

			led@1 {
				compatible = "mediatek,green";
				data = <0x1>;
				led_mode = <0x0>;
				phandle = <0x3e>;
				pwm_config = <0x0 0x0 0x0 0x0 0x0>;
			};

			led@2 {
				compatible = "mediatek,blue";
				data = <0x1>;
				led_mode = <0x0>;
				phandle = <0x3f>;
				pwm_config = <0x0 0x0 0x0 0x0 0x0>;
			};

			led@3 {
				compatible = "mediatek,jogball-backlight";
				data = <0x1>;
				led_mode = <0x0>;
				phandle = <0x40>;
				pwm_config = <0x0 0x0 0x0 0x0 0x0>;
			};

			led@4 {
				compatible = "mediatek,keyboard-backlight";
				data = <0x1>;
				led_mode = <0x0>;
				phandle = <0x41>;
				pwm_config = <0x0 0x0 0x0 0x0 0x0>;
			};

			led@5 {
				compatible = "mediatek,button-backlight";
				data = <0x1>;
				led_mode = <0x0>;
				phandle = <0x42>;
				pwm_config = <0x0 0x0 0x0 0x0 0x0>;
			};

			led@6 {
				compatible = "mediatek,lcd-backlight";
				data = <0x1>;
				led_mode = <0x5>;
				phandle = <0x43>;
				pwm_config = <0x0 0x3 0x0 0x0 0x0>;
			};

			vibrator@0 {
				compatible = "mediatek,vibrator";
				phandle = <0x44>;
				vib_limit = <0x9>;
				vib_timer = <0x19>;
				vib_vol = <0xb>;
			};
		};
	};

	fragment@20 {
		target = <0xffffffff>;

		__overlay__ {
			status = "okay";

			cs35l41@0 {
				cirrus,boost-cap-microfarad = <0xf>;
				cirrus,boost-ind-nanohenry = <0x3e8>;
				cirrus,boost-peak-milliamp = <0xfa0>;
				compatible = "cirrus,cs35l41";
				interrupt-parent = <0xffffffff>;
				interrupts = <0x50 0x8>;
				irq-gpio = <0xffffffff 0x50 0x0>;
				phandle = <0x4c>;
				reg = <0x0>;
				reset-gpio = <0xffffffff 0x4f 0x0>;
				spi-max-frequency = <0x3d0900>;

				cirrus,gpio-config2 {
					cirrus,gpio-output-enable;
					cirrus,gpio-src-select = <0x4>;
				};
			};
		};
	};

	fragment@21 {
		target = <0xffffffff>;

		__overlay__ {
			status = "ok";

			aw2023@45 {
				compatible = "awinic,aw2023_led";
				reg = <0x45>;

				aw2023,blue {
					aw2023,fall-time-ms = <0x6>;
					aw2023,hold-time-ms = <0x0>;
					aw2023,id = <0x2>;
					aw2023,imax = <0x2>;
					aw2023,led-current = <0x3>;
					aw2023,max-brightness = <0xff>;
					aw2023,name = "blue";
					aw2023,off-time-ms = <0x4>;
					aw2023,rise-time-ms = <0x6>;
				};

				aw2023,green {
					aw2023,fall-time-ms = <0x6>;
					aw2023,hold-time-ms = <0x0>;
					aw2023,id = <0x1>;
					aw2023,imax = <0x2>;
					aw2023,led-current = <0x3>;
					aw2023,max-brightness = <0xff>;
					aw2023,name = "green";
					aw2023,off-time-ms = <0x4>;
					aw2023,rise-time-ms = <0x6>;
				};

				aw2023,red {
					aw2023,fall-time-ms = <0x6>;
					aw2023,hold-time-ms = <0x0>;
					aw2023,id = <0x0>;
					aw2023,imax = <0x1>;
					aw2023,led-current = <0xa>;
					aw2023,max-brightness = <0xff>;
					aw2023,name = "red";
					aw2023,off-time-ms = <0x4>;
					aw2023,rise-time-ms = <0x6>;
				};
			};
		};
	};

	fragment@22 {
		target = <0xffffffff>;

		__overlay__ {
			#address-cells = <0x1>;
			#size-cells = <0x0>;
			status = "ok";

			fpc_tee@0 {
				compatible = "goodix,goodix-fp";
				fpc,enable-wakeup;
				netlink-event = <0x1e>;
				reg = <0x0>;
				spi-max-frequency = <0x989680>;
				status = "okay";
			};
		};
	};

	fragment@23 {
		target = <0xffffffff>;

		__overlay__ {
			fpc,gpio_irq = <0xffffffff 0x8 0x0>;
			pinctrl-0 = <0xe>;
			pinctrl-1 = <0xf>;
			pinctrl-2 = <0x10>;
			pinctrl-names = "default", "reset_high", "reset_low";
			status = "okay";
		};
	};

	fragment@24 {
		target = <0xffffffff>;

		__overlay__ {

			state_default {
				phandle = <0xe>;

				pins_cmd_dat {
					bias-disable;
					pinmux = <0x806>;
					slew-rate = <0x0>;
				};
			};

			state_reset_high {
				phandle = <0xf>;

				pins_cmd_dat {
					output-high;
					pinmux = <0x1f00>;
					slew-rate = <0x1>;
				};
			};

			state_reset_low {
				phandle = <0x10>;

				pins_cmd_dat {
					output-low;
					pinmux = <0x1f00>;
					slew-rate = <0x1>;
				};
			};
		};
	};

	fragment@25 {
		target = <0xffffffff>;

		__overlay__ {

			adc_channel@ {
				compatible = "mediatek,adc_channel";
				mediatek,adc_fdd_rf_params_dynamic_custom_ch = <0x2>;
				mediatek,temperature0 = <0x0>;
				mediatek,temperature1 = <0x1>;
				status = "okay";
			};
		};
	};

	fragment@26 {
		target = <0xffffffff>;

		__overlay__ {
			io-channels = <0xffffffff 0x2>;
		};
	};

	fragment@27 {
		target = <0xffffffff>;

		__overlay__ {
			mediatek,clkbuf-config = <0x2 0x1 0x1 0x2 0x0 0x0 0x0>;
			mediatek,clkbuf-driving-current = <0x1 0x1 0x1 0x1 0x1 0x1 0x1>;
			mediatek,clkbuf-quantity = <0x7>;
			status = "okay";
		};
	};

	fragment@28 {
		target = <0xffffffff>;

		__overlay__ {
			#address-cells = <0x1>;
			#size-cells = <0x0>;
			clock-frequency = <0x61a80>;
			mediatek,use-open-drain;
		};
	};

	fragment@29 {
		target = <0xffffffff>;

		__overlay__ {
			#address-cells = <0x1>;
			#size-cells = <0x0>;
			clock-frequency = <0x61a80>;
			mediatek,use-open-drain;
		};
	};

	fragment@3 {
		target = <0xffffffff>;

		__overlay__ {
			interrupt-parent = <0xffffffff>;
			pinctrl-0 = <0xffffffff>;
			pinctrl-1 = <0xffffffff>;
			pinctrl-names = "reverse_high", "reverse_low";
			reverse-gpio = <0xffffffff 0x5b 0x0>;
		};
	};

	fragment@30 {
		target = <0xffffffff>;

		__overlay__ {
			#address-cells = <0x1>;
			#size-cells = <0x0>;
			clock-frequency = <0x61a80>;
			mediatek,use-open-drain;

			camera_main@5a {
				compatible = "mediatek,camera_main";
				phandle = <0x4d>;
				reg = <0x5a>;
				status = "okay";
			};

			camera_main_af@18 {
				compatible = "mediatek,camera_main_af";
				phandle = <0x4f>;
				reg = <0x18>;
				status = "okay";
			};

			camera_main_eeprom@52 {
				compatible = "mediatek,camera_main_eeprom";
				phandle = <0x4e>;
				reg = <0x52>;
				status = "okay";
			};

			camera_main_two@20 {
				compatible = "mediatek,camera_main_two";
				phandle = <0x50>;
				reg = <0x20>;
				status = "okay";
			};

			camera_main_two_eeprom@54 {
				compatible = "mediatek,camera_main_two_eeprom";
				phandle = <0x51>;
				reg = <0x54>;
				status = "okay";
			};

			ccu_sensor_i2c_2_hw@11 {
				compatible = "mediatek,ccu_sensor_i2c_2_hw";
				phandle = <0x52>;
				reg = <0x11>;
				status = "okay";
			};
		};
	};

	fragment@31 {
		target = <0xffffffff>;

		__overlay__ {
			#address-cells = <0x1>;
			#size-cells = <0x0>;
			clock-frequency = <0x61a80>;
			mediatek,use-open-drain;

			nfc@08 {
				compatible = "mediatek,nfc";
				phandle = <0x53>;
				reg = <0x8>;
				status = "okay";
			};
		};
	};

	fragment@32 {
		target = <0xffffffff>;

		__overlay__ {
			#address-cells = <0x1>;
			#size-cells = <0x0>;
			clock-frequency = <0x61a80>;
			mediatek,use-open-drain;

			camera_main_three@2e {
				compatible = "mediatek,camera_main_three";
				phandle = <0x58>;
				reg = <0x2e>;
				status = "okay";
			};

			camera_main_three_af@18 {
				compatible = "mediatek,camera_main_three_af";
				phandle = <0x59>;
				reg = <0x18>;
				status = "okay";
			};

			camera_main_three_eeprom@51 {
				compatible = "mediatek,camera_main_three_eeprom";
				phandle = <0x5b>;
				reg = <0x51>;
				status = "okay";
			};

			camera_sub@6c {
				compatible = "mediatek,camera_sub";
				phandle = <0x54>;
				reg = <0x6c>;
				status = "okay";
			};

			camera_sub_eeprom@50 {
				compatible = "mediatek,camera_sub_eeprom";
				phandle = <0x55>;
				reg = <0x50>;
				status = "okay";
			};

			camera_sub_two@6e {
				compatible = "mediatek,camera_sub_two";
				phandle = <0x57>;
				reg = <0x6e>;
				status = "okay";
			};

			camera_sub_two_eeprom@37 {
				compatible = "mediatek,camera_sub_two_eeprom";
				phandle = <0x5a>;
				reg = <0x37>;
				status = "okay";
			};

			ccu_sensor_i2c_4_hw@12 {
				compatible = "mediatek,ccu_sensor_i2c_4_hw";
				phandle = <0x56>;
				reg = <0x12>;
				status = "okay";
			};
		};
	};

	fragment@33 {
		target = <0xffffffff>;

		__overlay__ {
			#address-cells = <0x1>;
			#size-cells = <0x0>;
			clock-frequency = <0x33e140>;
			mediatek,use-push-pull;

			subpmic_pmu@34 {
				compatible = "mediatek,subpmic_pmu";
				phandle = <0x5c>;
				reg = <0x34>;
				status = "okay";
			};
		};
	};

	fragment@34 {
		target = <0xffffffff>;

		__overlay__ {
			#address-cells = <0x1>;
			#size-cells = <0x0>;
			clock-frequency = <0x61a80>;
			mediatek,use-open-drain;
		};
	};

	fragment@35 {
		target = <0xffffffff>;

		__overlay__ {
			#address-cells = <0x1>;
			#size-cells = <0x0>;
			clock-frequency = <0x61a80>;
			mediatek,use-open-drain;

			smb1351_charger@55 {
				compatible = "mediatek,smb1351_charger";
				phandle = <0x5e>;
				reg = <0x55>;
				status = "okay";
			};

			usb_type_c@60 {
				compatible = "mediatek,usb_type_c";
				phandle = <0x5d>;
				reg = <0x60>;
				status = "okay";
			};
		};
	};

	fragment@36 {
		target = <0xffffffff>;

		__overlay__ {
			#address-cells = <0x1>;
			#size-cells = <0x0>;
			clock-frequency = <0x61a80>;
			mediatek,use-open-drain;
		};
	};

	fragment@37 {
		target = <0xffffffff>;

		__overlay__ {
			GPIO_FDD_BAND_SUPPORT_DETECT_1ST_PIN = <0xffffffff 0x5 0x0>;
			GPIO_FDD_BAND_SUPPORT_DETECT_2ND_PIN = <0xffffffff 0x6 0x0>;
			GPIO_SIM1_HOT_PLUG = <0xffffffff 0x2f 0x0>;
			GPIO_SIM1_SCLK = <0xffffffff 0xac 0x0>;
			GPIO_SIM1_SIO = <0xffffffff 0xae 0x0>;
			GPIO_SIM1_SRST = <0xffffffff 0xad 0x0>;
			GPIO_SIM2_HOT_PLUG = <0xffffffff 0x2e 0x0>;
			GPIO_SIM2_SCLK = <0xffffffff 0x9d 0x0>;
			GPIO_SIM2_SIO = <0xffffffff 0x9b 0x0>;
			GPIO_SIM2_SRST = <0xffffffff 0x9c 0x0>;
		};
	};

	fragment@38 {
		target = <0xffffffff>;

		__overlay__ {
			gpio_init_default = <0x0 0x0 0x0 0x0 0x1 0x1 0x1 0x1 0x0 0x0 0x0 0x1 0x1 0x1 0x2 0x0 0x0 0x0 0x1 0x0 0x1 0x3 0x0 0x1 0x0 0x0 0x0 0x1 0x4 0x0 0x1 0x0 0x0 0x0 0x0 0x5 0x0 0x0 0x0 0x0 0x0 0x0 0x6 0x0 0x0 0x0 0x0 0x0 0x0 0x7 0x0 0x1 0x0 0x0 0x0 0x0 0x8 0x0 0x0 0x0 0x1 0x0 0x0 0x9 0x0 0x0 0x0 0x1 0x0 0x0 0xa 0x0 0x0 0x0 0x1 0x1 0x0 0xb 0x0 0x0 0x0 0x1 0x1 0x0 0xc 0x4 0x1 0x0 0x0 0x0 0x0 0xd 0x0 0x0 0x0 0x1 0x0 0x0 0xe 0x0 0x0 0x0 0x1 0x0 0x0 0xf 0x2 0x1 0x0 0x0 0x0 0x0 0x10 0x0 0x0 0x0 0x1 0x0 0x0 0x11 0x0 0x0 0x0 0x1 0x0 0x1 0x12 0x0 0x0 0x0 0x1 0x1 0x1 0x13 0x0 0x0 0x0 0x1 0x0 0x1 0x14 0x0 0x0 0x0 0x1 0x1 0x1 0x15 0x2 0x0 0x0 0x0 0x0 0x0 0x16 0x2 0x1 0x1 0x0 0x0 0x0 0x17 0x2 0x1 0x0 0x0 0x0 0x0 0x18 0x2 0x1 0x0 0x0 0x0 0x0 0x19 0x2 0x1 0x1 0x0 0x0 0x0 0x1a 0x2 0x1 0x0 0x0 0x0 0x0 0x1b 0x2 0x1 0x0 0x0 0x0 0x0 0x1c 0x2 0x0 0x0 0x0 0x0 0x0 0x1d 0x0 0x0 0x0 0x0 0x0 0x0 0x1e 0x0 0x1 0x0 0x0 0x0 0x0 0x1f 0x0 0x1 0x0 0x1 0x0 0x0 0x20 0x1 0x0 0x0 0x0 0x0 0x0 0x21 0x1 0x1 0x1 0x0 0x0 0x0 0x22 0x1 0x1 0x0 0x0 0x0 0x0 0x23 0x1 0x1 0x0 0x0 0x0 0x0 0x24 0x0 0x1 0x1 0x0 0x0 0x0 0x25 0x0 0x1 0x1 0x0 0x0 0x0 0x26 0x0 0x1 0x1 0x0 0x0 0x0 0x27 0x0 0x0 0x0 0x1 0x0 0x1 0x28 0x2 0x0 0x0 0x1 0x0 0x0 0x29 0x0 0x0 0x0 0x1 0x1 0x1 0x2a 0x0 0x0 0x0 0x1 0x0 0x1 0x2b 0x1 0x1 0x0 0x0 0x0 0x0 0x2c 0x1 0x0 0x0 0x1 0x0 0x0 0x2d 0x0 0x1 0x0 0x0 0x0 0x0 0x2e 0x1 0x0 0x0 0x1 0x1 0x0 0x2f 0x1 0x0 0x0 0x1 0x1 0x0 0x30 0x0 0x0 0x0 0x1 0x0 0x1 0x31 0x0 0x0 0x0 0x1 0x0 0x1 0x32 0x0 0x0 0x0 0x1 0x0 0x1 0x33 0x0 0x0 0x0 0x1 0x0 0x1 0x34 0x0 0x0 0x0 0x1 0x0 0x0 0x35 0x1 0x0 0x0 0x1 0x0 0x0 0x36 0x1 0x0 0x0 0x1 0x0 0x0 0x37 0x0 0x0 0x0 0x0 0x0 0x0 0x38 0x0 0x0 0x0 0x0 0x0 0x0 0x39 0x1 0x0 0x0 0x1 0x0 0x0 0x3a 0x0 0x0 0x0 0x1 0x0 0x0 0x3b 0x1 0x0 0x0 0x1 0x0 0x0 0x3c 0x1 0x0 0x0 0x1 0x0 0x0 0x3d 0x1 0x0 0x0 0x1 0x0 0x0 0x3e 0x1 0x0 0x0 0x1 0x0 0x0 0x3f 0x1 0x0 0x0 0x1 0x0 0x0 0x40 0x1 0x0 0x0 0x1 0x0 0x0 0x41 0x0 0x0 0x0 0x1 0x0 0x0 0x42 0x0 0x0 0x0 0x1 0x0 0x0 0x43 0x1 0x0 0x0 0x1 0x0 0x0 0x44 0x1 0x0 0x0 0x1 0x0 0x0 0x45 0x1 0x0 0x0 0x1 0x0 0x0 0x46 0x1 0x0 0x0 0x1 0x0 0x0 0x47 0x1 0x0 0x0 0x1 0x0 0x0 0x48 0x1 0x0 0x0 0x1 0x0 0x0 0x49 0x1 0x0 0x0 0x1 0x0 0x0 0x4a 0x1 0x0 0x0 0x1 0x0 0x0 0x4b 0x1 0x0 0x0 0x1 0x0 0x0 0x4c 0x1 0x0 0x0 0x1 0x0 0x0 0x4d 0x1 0x0 0x0 0x1 0x0 0x0 0x4e 0x1 0x0 0x0 0x0 0x0 0x0 0x4f 0x0 0x1 0x0 0x1 0x0 0x1 0x50 0x0 0x0 0x0 0x1 0x1 0x1 0x51 0x2 0x0 0x0 0x1 0x1 0x1 0x52 0x1 0x0 0x0 0x1 0x1 0x1 0x53 0x1 0x0 0x0 0x1 0x1 0x1 0x54 0x2 0x0 0x0 0x1 0x1 0x1 0x55 0x2 0x0 0x0 0x1 0x0 0x0 0x56 0x2 0x1 0x0 0x0 0x0 0x0 0x57 0x2 0x1 0x0 0x0 0x0 0x0 0x58 0x2 0x1 0x0 0x0 0x0 0x0 0x59 0x1 0x0 0x0 0x1 0x1 0x1 0x5a 0x1 0x0 0x0 0x1 0x1 0x1 0x5b 0x0 0x0 0x0 0x1 0x0 0x0 0x5c 0x0 0x1 0x0 0x0 0x0 0x0 0x5d 0x1 0x0 0x0 0x1 0x1 0x0 0x5e 0x0 0x1 0x0 0x0 0x0 0x0 0x5f 0x1 0x0 0x0 0x1 0x1 0x0 0x60 0x1 0x1 0x0 0x0 0x0 0x0 0x61 0x0 0x0 0x0 0x1 0x0 0x0 0x62 0x0 0x0 0x0 0x1 0x0 0x0 0x63 0x1 0x1 0x0 0x0 0x0 0x0 0x64 0x1 0x1 0x0 0x0 0x0 0x0 0x65 0x0 0x1 0x0 0x0 0x0 0x0 0x66 0x0 0x1 0x0 0x0 0x0 0x0 0x67 0x1 0x0 0x0 0x1 0x1 0x1 0x68 0x1 0x0 0x0 0x1 0x1 0x1 0x69 0x1 0x0 0x0 0x1 0x1 0x1 0x6a 0x1 0x0 0x0 0x1 0x1 0x1 0x6b 0x0 0x0 0x0 0x1 0x0 0x0 0x6c 0x1 0x1 0x0 0x0 0x0 0x0 0x6d 0x0 0x1 0x0 0x0 0x0 0x0 0x6e 0x0 0x1 0x0 0x0 0x0 0x0 0x6f 0x1 0x1 0x0 0x0 0x0 0x0 0x70 0x0 0x1 0x0 0x0 0x0 0x0 0x71 0x0 0x0 0x0 0x1 0x0 0x0 0x72 0x0 0x0 0x0 0x1 0x0 0x0 0x73 0x0 0x0 0x0 0x1 0x0 0x0 0x74 0x0 0x0 0x0 0x1 0x0 0x0 0x75 0x0 0x0 0x0 0x1 0x0 0x0 0x76 0x0 0x0 0x0 0x1 0x0 0x0 0x77 0x0 0x0 0x0 0x1 0x0 0x0 0x78 0x0 0x0 0x0 0x1 0x0 0x0 0x79 0x0 0x0 0x0 0x1 0x0 0x0 0x86 0x1 0x0 0x0 0x1 0x0 0x1 0x87 0x1 0x1 0x0 0x0 0x0 0x0 0x88 0x1 0x1 0x0 0x0 0x0 0x0 0x89 0x1 0x1 0x0 0x0 0x0 0x0 0x8a 0x1 0x1 0x0 0x0 0x0 0x0 0x8b 0x1 0x1 0x0 0x0 0x0 0x0 0x8c 0x1 0x0 0x0 0x1 0x0 0x0 0x8d 0x1 0x0 0x0 0x1 0x0 0x0 0x8e 0x1 0x0 0x0 0x1 0x0 0x0 0x8f 0x1 0x0 0x0 0x1 0x0 0x0 0x90 0x1 0x0 0x0 0x1 0x0 0x0 0x91 0x1 0x1 0x0 0x0 0x0 0x0 0x92 0x1 0x1 0x0 0x0 0x0 0x0 0x93 0x1 0x1 0x0 0x0 0x0 0x0 0x94 0x1 0x1 0x0 0x0 0x0 0x0 0x95 0x1 0x1 0x0 0x0 0x0 0x0 0x96 0x0 0x0 0x0 0x1 0x0 0x0 0x97 0x0 0x1 0x0 0x0 0x0 0x0 0x98 0x0 0x1 0x0 0x0 0x0 0x0 0x99 0x0 0x1 0x0 0x0 0x0 0x0 0x9a 0x1 0x1 0x0 0x0 0x0 0x0 0x9b 0x1 0x0 0x0 0x1 0x1 0x0 0x9c 0x1 0x1 0x0 0x0 0x0 0x0 0x9d 0x1 0x1 0x0 0x0 0x0 0x0 0x9e 0x1 0x1 0x0 0x0 0x0 0x0 0x9f 0x0 0x0 0x0 0x1 0x0 0x0 0xa0 0x0 0x1 0x0 0x0 0x0 0x0 0xa1 0x1 0x0 0x0 0x1 0x1 0x1 0xa2 0x1 0x0 0x0 0x1 0x1 0x1 0xa3 0x1 0x0 0x0 0x1 0x1 0x1 0xa4 0x1 0x0 0x0 0x1 0x1 0x1 0xa5 0x0 0x1 0x0 0x0 0x0 0x0 0xa6 0x0 0x1 0x0 0x0 0x0 0x0 0xa7 0x1 0x0 0x0 0x1 0x0 0x0 0xa8 0x1 0x0 0x0 0x1 0x0 0x0 0xa9 0x0 0x1 0x0 0x0 0x0 0x0 0xaa 0x1 0x0 0x0 0x1 0x1 0x1 0xab 0x1 0x1 0x0 0x0 0x0 0x1 0xac 0x1 0x1 0x0 0x0 0x0 0x0 0xad 0x1 0x1 0x0 0x0 0x0 0x0 0xae 0x1 0x0 0x0 0x1 0x1 0x0 0xaf 0x1 0x0 0x0 0x1 0x1 0x1 0xb0 0x1 0x0 0x0 0x1 0x1 0x1 0xb2 0x0 0x1 0x0 0x0 0x0 0x0 0xb3 0x0 0x1 0x0 0x0 0x0 0x0 0xb4 0x0 0x0 0x0 0x1 0x0 0x0 0xb5 0x0 0x0 0x0 0x1 0x0 0x0 0xb6 0x0 0x0 0x0 0x1 0x0 0x0 0xb7 0x0 0x0 0x0 0x1 0x0 0x0 0xb8 0x0 0x0 0x0 0x1 0x0 0x0 0xb9 0x0 0x0 0x0 0x1 0x0 0x0 0xba 0x0 0x0 0x0 0x1 0x0 0x0>;
		};
	};

	fragment@39 {
		target = <0xffffffff>;

		__overlay__ {
			deb-gpios = <0xffffffff 0x0 0x0>;
			debounce = <0x7d000>;
			interrupt-parent = <0xffffffff>;
			interrupts = <0x0 0x8 0x0 0x0>;
			status = "okay";
		};
	};

	fragment@4 {
		target = <0xffffffff>;

		__overlay__ {

			fusb303@21 {
				compatible = "on,fusb303";
				fusb303,autosink-threshold = <0x1>;
				fusb303,cc-debounce-time = <0x3>;
				fusb303,drp-duty-time = <0x0>;
				fusb303,drp-toggle-time = <0x1>;
				fusb303,host-current = <0x2>;
				fusb303,init-mode = <0x14>;
				fusb303,int-gpio = <0xffffffff 0x29 0x0>;
				interrupt-parent = <0xffffffff>;
				interrupts = <0x29 0x2>;
				reg = <0x21>;
				status = "ok";
			};
		};
	};

	fragment@40 {
		target = <0xffffffff>;

		__overlay__ {
			interrupt-parent = <0xffffffff>;
			interrupts = <0x1 0x2 0x1 0x0>;
			status = "okay";
		};
	};

	fragment@41 {
		target = <0xffffffff>;

		__overlay__ {
			interrupt-parent = <0xffffffff>;
			interrupts = <0x8 0x2 0x8 0x0>;
			status = "okay";
		};
	};

	fragment@42 {
		target = <0xffffffff>;

		__overlay__ {
			interrupt-parent = <0xffffffff>;
			interrupts = <0x14 0x2 0x14 0x0>;
			status = "okay";
		};
	};

	fragment@43 {
		target = <0xffffffff>;

		__overlay__ {
			interrupt-parent = <0xffffffff>;
			interrupts = <0x29 0x2 0x29 0x0>;
			status = "okay";
		};
	};

	fragment@44 {
		target = <0xffffffff>;

		__overlay__ {
			interrupt-parent = <0xffffffff>;
			interrupts = <0x2c 0x1 0x2c 0x1>;
			status = "okay";
		};
	};

	fragment@45 {
		target = <0xffffffff>;

		__overlay__ {
			deb-gpios = <0xffffffff 0x37 0x0>;
			debounce = <0x7d000>;
			interrupt-parent = <0xffffffff>;
			interrupts = <0x37 0x8 0x37 0x0>;
			status = "okay";
		};
	};

	fragment@46 {
		target = <0xffffffff>;

		__overlay__ {
			deb-gpios = <0xffffffff 0x38 0x0>;
			debounce = <0x7d000>;
			interrupt-parent = <0xffffffff>;
			interrupts = <0x38 0x8 0x38 0x0>;
			status = "okay";
		};
	};

	fragment@47 {
		target = <0xffffffff>;

		__overlay__ {
			interrupt-parent = <0xffffffff>;
			interrupts = <0x90 0x4 0xb4 0x0>;
			status = "okay";
		};
	};

	fragment@48 {
		target = <0xffffffff>;

		__overlay__ {
			compatible = "mediatek,md1_sim1_hot_plug_eint-eint";
			debounce = <0x0 0x2710>;
			dedicated = <0x0 0x0>;
			interrupts = <0x0 0x8>;
			sockettype = <0x0 0x0>;
			src_pin = <0x0 0x1>;
			status = "okay";
		};
	};

	fragment@49 {
		target = <0xffffffff>;

		__overlay__ {
			compatible = "mediatek,md1_sim2_hot_plug_eint-eint";
			debounce = <0x1 0x2710>;
			dedicated = <0x1 0x0>;
			interrupts = <0x1 0x8>;
			sockettype = <0x1 0x0>;
			src_pin = <0x1 0x2>;
			status = "okay";
		};
	};

	fragment@5 {
		target = <0xffffffff>;

		__overlay__ {

			smb1351-charger@55 {
				charger_name = "primary_chg";
				compatible = "qcom,smb1351_charger";
				cv = <0x434a90>;
				en_st;
				en_wdt;
				ichg = <0x1b7740>;
				ieoc = <0x30d40>;
				interrupt-parent = <0xffffffff>;
				interrupts = <0x14 0x2 0x14 0x0>;
				mivr = <0x44aa20>;
				qcom,bc12_supported;
				qcom,recharge-disabled;
				qcom,recharge-mv = <0x64>;
				reg = <0x55>;
				safety_timer = <0xc>;
			};
		};
	};

	fragment@50 {
		target = <0xffffffff>;

		__overlay__ {
			regulator-default-on = <0x1>;
			regulator-name = "vcama1";
			status = "okay";
		};
	};

	fragment@51 {
		target = <0xffffffff>;

		__overlay__ {
			regulator-default-on = <0x1>;
			regulator-name = "vcama2";
			status = "okay";
		};
	};

	fragment@52 {
		target = <0xffffffff>;

		__overlay__ {
			regulator-default-on = <0x1>;
			regulator-name = "vsim1";
			status = "okay";
		};
	};

	fragment@53 {
		target = <0xffffffff>;

		__overlay__ {
			regulator-default-on = <0x1>;
			regulator-name = "vsim2";
			status = "okay";
		};
	};

	fragment@54 {
		target = <0xffffffff>;

		__overlay__ {
			regulator-default-on = <0x1>;
			regulator-name = "vcamd";
			status = "okay";
		};
	};

	fragment@55 {
		target = <0xffffffff>;

		__overlay__ {
			regulator-default-on = <0x1>;
			regulator-name = "vcamio";
			status = "okay";
		};
	};

	fragment@56 {
		target = <0xffffffff>;

		__overlay__ {
			regulator-default-on = <0x1>;
			regulator-name = "vldo28";
			status = "okay";
		};
	};

	fragment@57 {
		target = <0xffffffff>;

		__overlay__ {
			status = "okay";
			vcama-supply = <0xffffffff>;
			vcama_sub-supply = <0xffffffff>;
			vcamaf-supply = <0xffffffff>;
			vcamaf_main2-supply = <0xffffffff>;
			vcamaf_sub-supply = <0xffffffff>;
			vcamd_main2-supply = <0xffffffff>;
			vcamio-supply = <0xffffffff>;
			vcamio_main2-supply = <0xffffffff>;
			vcamio_sub-supply = <0xffffffff>;
		};
	};

	fragment@58 {
		target = <0xffffffff>;

		__overlay__ {
			status = "okay";
			vtouch-supply = <0xffffffff>;
		};
	};

	fragment@59 {
		target = <0xffffffff>;

		__overlay__ {
			mediatek,kpd-hw-dl-key0 = <0x11>;
			mediatek,kpd-hw-dl-key1 = <0x0>;
			mediatek,kpd-hw-dl-key2 = <0x8>;
			mediatek,kpd-hw-factory-key = <0x0>;
			mediatek,kpd-hw-init-map = <0x72 0x0 0x0 0x0 0x0 0x0 0x0 0x0 0x0 0x0 0x0 0x0 0x0 0x0 0x0 0x0 0x0 0x0 0x0 0x0 0x0 0x0 0x0 0x0 0x0 0x0 0x0 0x0 0x0 0x0 0x0 0x0 0x0 0x0 0x0 0x0 0x0 0x0 0x0 0x0 0x0 0x0 0x0 0x0 0x0 0x0 0x0 0x0 0x0 0x0 0x0 0x0 0x0 0x0 0x0 0x0 0x0 0x0 0x0 0x0 0x0 0x0 0x0 0x0 0x0 0x0 0x0 0x0 0x0 0x0 0x0 0x0>;
			mediatek,kpd-hw-map-num = <0x48>;
			mediatek,kpd-hw-pwrkey = <0x8>;
			mediatek,kpd-hw-recovery-key = <0x11>;
			mediatek,kpd-hw-rstkey = <0x11>;
			mediatek,kpd-key-debounce = <0x400>;
			mediatek,kpd-pwkey-gpio-din = <0x0>;
			mediatek,kpd-pwrkey-eint-gpio = <0x0>;
			mediatek,kpd-sw-pwrkey = <0x74>;
			mediatek,kpd-sw-rstkey = <0x73>;
			mediatek,kpd-use-extend-type = <0x0>;
			status = "okay";
		};
	};

	fragment@6 {
		target = <0xffffffff>;

		__overlay__ {
			ac_charger_current = <0x186a00>;
			non_std_ac_charger_current = <0x186a00>;
			temp_t1_threshold = <0x0>;
			temp_t3_threshold = <0x2d>;
			temp_t4_threshold = <0x37>;
		};
	};

	fragment@60 {
		target = <0xffffffff>;

		__overlay__ {

			camdefault {
				phandle = <0x11>;
			};

			camera0_mclk_2mA@gpio100 {
				phandle = <0x23>;

				pins_cmd_dat {
					drive-strength = <0x2>;
					pinmux = <0x6401>;
				};
			};

			camera0_mclk_4mA@gpio100 {
				phandle = <0x24>;

				pins_cmd_dat {
					drive-strength = <0x4>;
					pinmux = <0x6401>;
				};
			};

			camera0_mclk_6mA@gpio100 {
				phandle = <0x25>;

				pins_cmd_dat {
					drive-strength = <0x6>;
					pinmux = <0x6401>;
				};
			};

			camera0_mclk_8mA@gpio100 {
				phandle = <0x26>;

				pins_cmd_dat {
					drive-strength = <0x7>;
					pinmux = <0x6401>;
				};
			};

			camera0_mclk_gpio_mode@gpio100 {
				phandle = <0x22>;

				pins_cmd_dat {
					drive-strength = <0x4>;
					pinmux = <0x6400>;
				};
			};

			camera0_rst_output_high@gpio102 {
				phandle = <0x13>;

				pins_cmd_dat {
					output-high;
					pinmux = <0x6600>;
				};
			};

			camera0_rst_output_low@gpio102 {
				phandle = <0x12>;

				pins_cmd_dat {
					output-low;
					pinmux = <0x6600>;
				};
			};

			camera0_vcamd_output_high@gpio179 {
				phandle = <0x1e>;

				pins_cmd_dat {
					output-high;
					pinmux = <0xb300>;
				};
			};

			camera0_vcamd_output_low@gpio179 {
				phandle = <0x1f>;

				pins_cmd_dat {
					output-low;
					pinmux = <0xb300>;
				};
			};

			camera1_mclk_2mA@gpio108 {
				phandle = <0x28>;

				pins_cmd_dat {
					drive-strength = <0x2>;
					pinmux = <0x6c01>;
				};
			};

			camera1_mclk_4mA@gpio108 {
				phandle = <0x29>;

				pins_cmd_dat {
					drive-strength = <0x4>;
					pinmux = <0x6c01>;
				};
			};

			camera1_mclk_6mA@gpio108 {
				phandle = <0x2a>;

				pins_cmd_dat {
					drive-strength = <0x6>;
					pinmux = <0x6c01>;
				};
			};

			camera1_mclk_8mA@gpio108 {
				phandle = <0x2b>;

				pins_cmd_dat {
					drive-strength = <0x7>;
					pinmux = <0x6c01>;
				};
			};

			camera1_mclk_gpio_mode@gpio108 {
				phandle = <0x27>;

				pins_cmd_dat {
					drive-strength = <0x4>;
					pinmux = <0x6c00>;
				};
			};

			camera1_rst_output_high@gpio109 {
				phandle = <0x15>;

				pins_cmd_dat {
					output-high;
					pinmux = <0x6d00>;
				};
			};

			camera1_rst_output_low@gpio109 {
				phandle = <0x14>;

				pins_cmd_dat {
					output-low;
					pinmux = <0x6d00>;
				};
			};

			camera1_vcama_output_high@gpio178 {
				phandle = <0x20>;

				pins_cmd_dat {
					output-high;
					pinmux = <0xb200>;
				};
			};

			camera1_vcama_output_low@gpio178 {
				phandle = <0x21>;

				pins_cmd_dat {
					output-low;
					pinmux = <0xb200>;
				};
			};

			camera2_mclk_2mA@gpio108 {
				phandle = <0x2d>;

				pins_cmd_dat {
					drive-strength = <0x2>;
					pinmux = <0x6c01>;
				};
			};

			camera2_mclk_4mA@gpio108 {
				phandle = <0x2e>;

				pins_cmd_dat {
					drive-strength = <0x4>;
					pinmux = <0x6c01>;
				};
			};

			camera2_mclk_6mA@gpio108 {
				phandle = <0x2f>;

				pins_cmd_dat {
					drive-strength = <0x6>;
					pinmux = <0x6c01>;
				};
			};

			camera2_mclk_8mA@gpio108 {
				phandle = <0x30>;

				pins_cmd_dat {
					drive-strength = <0x7>;
					pinmux = <0x6c01>;
				};
			};

			camera2_mclk_gpio_mode@gpio108 {
				phandle = <0x2c>;

				pins_cmd_dat {
					drive-strength = <0x4>;
					pinmux = <0x6c00>;
				};
			};

			camera2_mipisel_off@gpio4 {
				phandle = <0x3b>;

				pins_cmd_dat {
					output-low;
					pinmux = <0x400>;
				};
			};

			camera2_mipisel_on@gpio4 {
				phandle = <0x3c>;

				pins_cmd_dat {
					output-high;
					pinmux = <0x400>;
				};
			};

			camera2_rst_output_high@gpio7 {
				phandle = <0x17>;

				pins_cmd_dat {
					output-high;
					pinmux = <0x700>;
				};
			};

			camera2_rst_output_low@gpio7 {
				phandle = <0x16>;

				pins_cmd_dat {
					output-low;
					pinmux = <0x700>;
				};
			};

			camera3_mclk_2mA@gpio99 {
				phandle = <0x32>;

				pins_cmd_dat {
					drive-strength = <0x2>;
					pinmux = <0x6301>;
				};
			};

			camera3_mclk_4mA@gpio99 {
				phandle = <0x33>;

				pins_cmd_dat {
					drive-strength = <0x4>;
					pinmux = <0x6301>;
				};
			};

			camera3_mclk_6mA@gpio99 {
				phandle = <0x34>;

				pins_cmd_dat {
					drive-strength = <0x6>;
					pinmux = <0x6301>;
				};
			};

			camera3_mclk_8mA@gpio99 {
				phandle = <0x35>;

				pins_cmd_dat {
					drive-strength = <0x7>;
					pinmux = <0x6301>;
				};
			};

			camera3_mclk_gpio_mode@gpio99 {
				phandle = <0x31>;

				pins_cmd_dat {
					drive-strength = <0x4>;
					pinmux = <0x6300>;
				};
			};

			camera3_pdn_output_high@gpio17 {
				phandle = <0x1b>;

				pins_cmd_dat {
					output-high;
					pinmux = <0x1100>;
				};
			};

			camera3_pdn_output_low@gpio17 {
				phandle = <0x1a>;

				pins_cmd_dat {
					output-low;
					pinmux = <0x1100>;
				};
			};

			camera3_rst_output_high@gpio101 {
				phandle = <0x19>;

				pins_cmd_dat {
					output-high;
					pinmux = <0x6500>;
				};
			};

			camera3_rst_output_low@gpio101 {
				phandle = <0x18>;

				pins_cmd_dat {
					output-low;
					pinmux = <0x6500>;
				};
			};

			camera4_mclk_2mA@gpio111 {
				phandle = <0x37>;

				pins_cmd_dat {
					drive-strength = <0x2>;
					pinmux = <0x6f01>;
				};
			};

			camera4_mclk_4mA@gpio111 {
				phandle = <0x38>;

				pins_cmd_dat {
					drive-strength = <0x4>;
					pinmux = <0x6f01>;
				};
			};

			camera4_mclk_6mA@gpio111 {
				phandle = <0x39>;

				pins_cmd_dat {
					drive-strength = <0x6>;
					pinmux = <0x6f01>;
				};
			};

			camera4_mclk_8mA@gpio111 {
				phandle = <0x3a>;

				pins_cmd_dat {
					drive-strength = <0x7>;
					pinmux = <0x6f01>;
				};
			};

			camera4_mclk_gpio_mode@gpio111 {
				phandle = <0x36>;

				pins_cmd_dat {
					drive-strength = <0x4>;
					pinmux = <0x6f00>;
				};
			};

			camera4_rst_output_high@gpio112 {
				phandle = <0x1d>;

				pins_cmd_dat {
					output-high;
					pinmux = <0x7000>;
				};
			};

			camera4_rst_output_low@gpio112 {
				phandle = <0x1c>;

				pins_cmd_dat {
					output-low;
					pinmux = <0x7000>;
				};
			};
		};
	};

	fragment@61 {
		target = <0xffffffff>;

		__overlay__ {
			cam0_vcama-supply = <0xffffffff>;
			cam0_vcamio-supply = <0xffffffff>;
			cam1_vcamd-supply = <0xffffffff>;
			cam1_vcamio-supply = <0xffffffff>;
			cam2_vcama-supply = <0xffffffff>;
			cam2_vcamd-supply = <0xffffffff>;
			cam2_vcamio-supply = <0xffffffff>;
			cam3_vcama-supply = <0xffffffff>;
			cam3_vcamio-supply = <0xffffffff>;
			cam4_vcama-supply = <0xffffffff>;
			cam4_vcamio-supply = <0xffffffff>;
			pinctrl-0 = <0x11>;
			pinctrl-1 = <0x12>;
			pinctrl-10 = <0x1b>;
			pinctrl-11 = <0x1c>;
			pinctrl-12 = <0x1d>;
			pinctrl-13 = <0x1e>;
			pinctrl-14 = <0x1f>;
			pinctrl-15 = <0x20>;
			pinctrl-16 = <0x21>;
			pinctrl-17 = <0x22>;
			pinctrl-18 = <0x23>;
			pinctrl-19 = <0x24>;
			pinctrl-2 = <0x13>;
			pinctrl-20 = <0x25>;
			pinctrl-21 = <0x26>;
			pinctrl-22 = <0x27>;
			pinctrl-23 = <0x28>;
			pinctrl-24 = <0x29>;
			pinctrl-25 = <0x2a>;
			pinctrl-26 = <0x2b>;
			pinctrl-27 = <0x2c>;
			pinctrl-28 = <0x2d>;
			pinctrl-29 = <0x2e>;
			pinctrl-3 = <0x14>;
			pinctrl-30 = <0x2f>;
			pinctrl-31 = <0x30>;
			pinctrl-32 = <0x31>;
			pinctrl-33 = <0x32>;
			pinctrl-34 = <0x33>;
			pinctrl-35 = <0x34>;
			pinctrl-36 = <0x35>;
			pinctrl-37 = <0x36>;
			pinctrl-38 = <0x37>;
			pinctrl-39 = <0x38>;
			pinctrl-4 = <0x15>;
			pinctrl-40 = <0x39>;
			pinctrl-41 = <0x3a>;
			pinctrl-42 = <0x3b>;
			pinctrl-43 = <0x3c>;
			pinctrl-5 = <0x16>;
			pinctrl-6 = <0x17>;
			pinctrl-7 = <0x18>;
			pinctrl-8 = <0x19>;
			pinctrl-9 = <0x1a>;
			pinctrl-names = "default", "cam0_rst0", "cam0_rst1", "cam1_rst0", "cam1_rst1", "cam2_rst0", "cam2_rst1", "cam3_rst0", "cam3_rst1", "cam3_pnd0", "cam3_pnd1", "cam4_rst0", "cam4_rst1", "cam0_vcamd_on", "cam0_vcamd_off", "cam1_vcama_on", "cam1_vcama_off", "cam0_mclk_off", "cam0_mclk_2mA", "cam0_mclk_4mA", "cam0_mclk_6mA", "cam0_mclk_8mA", "cam1_mclk_off", "cam1_mclk_2mA", "cam1_mclk_4mA", "cam1_mclk_6mA", "cam1_mclk_8mA", "cam2_mclk_off", "cam2_mclk_2mA", "cam2_mclk_4mA", "cam2_mclk_6mA", "cam2_mclk_8mA", "cam3_mclk_off", "cam3_mclk_2mA", "cam3_mclk_4mA", "cam3_mclk_6mA", "cam3_mclk_8mA", "cam4_mclk_off", "cam4_mclk_2mA", "cam4_mclk_4mA", "cam4_mclk_6mA", "cam4_mclk_8mA", "cam_mipi_switch_sel_0", "cam_mipi_switch_sel_1";
			status = "okay";
		};
	};

	fragment@62 {
		target = <0xffffffff>;

		__overlay__ {

			flashlights_cust_pins_en_output_high@gpio152 {
				phandle = <0x2>;

				pins_cmd_dat {
					output-high;
					pinmux = <0x9800>;
				};
			};

			flashlights_cust_pins_en_output_low@gpio152 {
				phandle = <0x1>;

				pins_cmd_dat {
					output-low;
					pinmux = <0x9800>;
				};
			};

			flashlights_cust_pins_strobe_output_high@gpio153 {
				phandle = <0x4>;

				pins_cmd_dat {
					output-high;
					pinmux = <0x9900>;
				};
			};

			flashlights_cust_pins_strobe_output_low@gpio153 {
				phandle = <0x3>;

				pins_cmd_dat {
					output-low;
					pinmux = <0x9900>;
				};
			};
		};
	};

	fragment@63 {
		target = <0xffffffff>;

		__overlay__ {
			cam0_enable_sensor = "s5kgm1sp_ofilm_mipi_raw";
			cam1_enable_sensor = "ov13b10_ofilm_mipi_raw ov13855_ofilm_mipi_raw";
			cam2_enable_sensor = "ov8856_ofilm_mipi_raw";
			cam3_enable_sensor = "gc02m1_ofilm_mipi_raw";
			cam4_enable_sensor = "ov02a10_sunny_mipi_raw gc2375h_ofilm_mipi_raw";
		};
	};

	fragment@64 {
		target = <0xffffffff>;

		__overlay__ {
			status = "ok";

			touch@0 {
				#netlink-event = <0x1e>;
				compatible = "novatek,NVT-ts-spi", "focaltech,fts";
				focaltech,display-coords = <0x0 0x0 0x438 0x924>;
				focaltech,irq-gpio = <0xffffffff 0x1 0x2>;
				focaltech,max-touch-number = <0xa>;
				focaltech,reset-gpio = <0xffffffff 0x5c 0x1>;
				interrupt-parent = <0xffffffff>;
				interrupts = <0xd 0x2>;
				novatek,irq-gpio = <0xffffffff 0x1 0x2001>;
				novatek,mp-support-dt;
				novatek,reset-gpio = <0xffffffff 0x5c 0x0>;
				novatek,spi-rd-fast-addr = <0x3f310>;
				novatek,swrst-n8-addr = <0x3f0fe>;
				reg = <0x0>;
				spi-max-frequency = <0x7a1200>;
				status = "okay";

				novatek-mp-criteria-591F@0 {
					#address-cells = <0x1>;
					#size-cells = <0x0>;
					AIN_KEY = <0x0 0x1 0x2 0xff>;
					AIN_X = <0x0 0x1 0x2 0x3 0x4 0x5 0x6 0x7 0x8 0x9 0xa 0xb 0xc 0xd 0xe 0xf 0x10 0x11>;
					AIN_Y = <0x0 0x1 0x2 0x3 0x4 0x5 0x6 0x7 0x8 0x9 0xa 0xb 0xc 0xd 0xe 0xf 0x10 0x11 0x12 0x13 0x14 0x15 0x16 0x17 0x18 0x19 0x1a 0x1b 0x1c 0x1d 0x1e 0x1f 0x20 0x21 0x22 0x23>;
					IC_KEY_CFG_SIZE = <0x4>;
					IC_X_CFG_SIZE = <0x12>;
					IC_Y_CFG_SIZE = <0x24>;
					PS_Config_Diff_Test_Frame = <0x32>;
					PS_Config_Lmt_FW_CC_N = <0x43 0x4c 0x4b 0x4b 0x4a 0x49 0x49 0x49 0xffff0001 0xffff0001 0x45 0x45 0x43 0x43 0x44 0x45 0x43 0x42 0x4b 0x45 0x43 0x43 0x42 0x42 0x42 0x42 0x42 0x42 0x43 0x42 0x42 0x42 0x42 0x42 0x43 0x44 0x4f 0x43 0x42 0x42 0x41 0x40 0x40 0x40 0x40 0x40 0x42 0x42 0x42 0x41 0x42 0x42 0x42 0x44 0x47 0x43 0x42 0x42 0x42 0x42 0x41 0x41 0x41 0x42 0x43 0x43 0x42 0x42 0x43 0x43 0x44 0x45 0x45 0x43 0x42 0x42 0x42 0x41 0x40 0x40 0x40 0x40 0x42 0x42 0x41 0x41 0x42 0x42 0x42 0x44 0x46 0x44 0x43 0x43 0x42 0x42 0x42 0x42 0x42 0x42 0x43 0x42 0x42 0x42 0x42 0x42 0x43 0x45 0x45 0x43 0x42 0x42 0x41 0x40 0x40 0x40 0x40 0x42 0x43 0x42 0x42 0x42 0x42 0x42 0x43 0x45 0x46 0x43 0x42 0x42 0x42 0x42 0x42 0x41 0x41 0x44 0x44 0x43 0x42 0x42 0x43 0x43 0x43 0x45 0x45 0x43 0x42 0x42 0x42 0x41 0x42 0x41 0x40 0x44 0x42 0x42 0x42 0x42 0x42 0x42 0x42 0x44 0x46 0x44 0x43 0x43 0x42 0x42 0x42 0x42 0x42 0x45 0x42 0x42 0x42 0x42 0x42 0x42 0x42 0x45 0x45 0x42 0x42 0x42 0x41 0x40 0x41 0x40 0x40 0x45 0x42 0x42 0x42 0x42 0x42 0x42 0x42 0x45 0x46 0x42 0x42 0x42 0x41 0x41 0x41 0x41 0x40 0x46 0x43 0x43 0x42 0x43 0x43 0x43 0x44 0x46 0x45 0x42 0x42 0x42 0x42 0x41 0x41 0x41 0x40 0x45 0x42 0x42 0x42 0x42 0x42 0x42 0x42 0x45 0x45 0x43 0x43 0x43 0x42 0x42 0x42 0x43 0x42 0x45 0x42 0x42 0x42 0x42 0x42 0x42 0x43 0x45 0x45 0x42 0x42 0x42 0x41 0x41 0x41 0x42 0x40 0x45 0x42 0x42 0x42 0x42 0x42 0x43 0x43 0x45 0x46 0x43 0x42 0x42 0x42 0x42 0x42 0x43 0x42 0x45 0x43 0x43 0x42 0x43 0x43 0x43 0x44 0x46 0x45 0x43 0x42 0x42 0x42 0x42 0x42 0x42 0x41 0x45 0x42 0x42 0x41 0x41 0x42 0x42 0x42 0x45 0x45 0x43 0x43 0x43 0x42 0x42 0x42 0x42 0x42 0x45 0x43 0x42 0x42 0x42 0x42 0x43 0x43 0x45 0x45 0x42 0x42 0x42 0x41 0x41 0x41 0x41 0x40 0x45 0x43 0x42 0x42 0x42 0x42 0x42 0x43 0x45 0x45 0x43 0x42 0x42 0x42 0x42 0x42 0x42 0x43 0x45 0x43 0x43 0x43 0x43 0x43 0x44 0x44 0x46 0x45 0x42 0x42 0x42 0x42 0x42 0x42 0x42 0x42 0x44 0x42 0x42 0x41 0x42 0x42 0x42 0x43 0x45 0x45 0x43 0x43 0x43 0x42 0x42 0x43 0x42 0x42 0x45 0x42 0x42 0x42 0x42 0x42 0x42 0x43 0x46 0x45 0x42 0x42 0x42 0x41 0x41 0x42 0x42 0x40 0x44 0x42 0x42 0x42 0x42 0x42 0x43 0x43 0x46 0x45 0x42 0x42 0x42 0x42 0x42 0x42 0x42 0x41 0x45 0x43 0x43 0x43 0x43 0x44 0x45 0x45 0x48 0x44 0x42 0x42 0x42 0x42 0x41 0x42 0x42 0x40 0x42 0x41 0x42 0x42 0x42 0x42 0x42 0x43 0x46 0x44 0x43 0x43 0x43 0x43 0x43 0x43 0x43 0x42 0x43 0x42 0x42 0x42 0x43 0x43 0x43 0x45 0x47 0x44 0x42 0x42 0x42 0x42 0x42 0x42 0x42 0x41 0x42 0x42 0x42 0x42 0x42 0x43 0x43 0x44 0x46 0x45 0x43 0x43 0x43 0x42 0x42 0x43 0x44 0x42 0x43 0x42 0x43 0x43 0x43 0x44 0x45 0x45 0x48 0x45 0x43 0x43 0x42 0x42 0x42 0x42 0x43 0x42 0x42 0x42 0x42 0x42 0x42 0x43 0x43 0x44 0x46 0x45 0x44 0x44 0x43 0x43 0x43 0x43 0x44 0x42 0x43 0x42 0x42 0x42 0x43 0x43 0x44 0x45 0x48 0x45 0x43 0x42 0x42 0x42 0x42 0x42 0x42 0x40 0x42 0x42 0x42 0x42 0x42 0x43 0x43 0x45 0x47 0x45 0x43 0x43 0x43 0x42 0x42 0x43 0x43 0x42 0x43 0x42 0x42 0x43 0x43 0x44 0x45 0x45 0x48 0x44 0x43 0x43 0x42 0x42 0x42 0x43 0x43 0x41 0x42 0x42 0x41 0x42 0x42 0x42 0x43 0x45 0x47 0x45 0x44 0x44 0x43 0x43 0x43 0x45 0x44 0x42 0x48 0x48 0x48 0x48 0x49 0x49 0x4a 0x4c 0x51 0x44 0x43 0x42 0x42 0x42 0x42 0x43 0x42 0x41 0x41 0x43 0x44 0x42 0x42 0x42 0x42 0x43 0x44 0x43 0x4a 0x49 0x49 0x49 0x49 0x4b 0x4b 0x4b 0x49 0x49 0x4a 0x48 0x48 0x48 0x48 0x48 0x47 0x1e 0x1e 0x1e>;
					PS_Config_Lmt_FW_CC_P = <0x6e 0x7c 0x7a 0x7a 0x79 0x78 0x78 0x78 0xffff 0xffff 0x70 0x70 0x6e 0x6e 0x6f 0x70 0x6e 0x6b 0x7a 0x70 0x6e 0x6e 0x6d 0x6b 0x6b 0x6b 0x6b 0x6b 0x6e 0x6d 0x6b 0x6b 0x6b 0x6d 0x6e 0x6f 0x80 0x6e 0x6b 0x6b 0x6a 0x69 0x69 0x69 0x69 0x69 0x6d 0x6b 0x6b 0x6a 0x6b 0x6b 0x6d 0x6f 0x74 0x6e 0x6d 0x6d 0x6b 0x6b 0x6a 0x6a 0x6a 0x6b 0x6e 0x6e 0x6d 0x6d 0x6e 0x6e 0x6f 0x72 0x72 0x6e 0x6b 0x6b 0x6b 0x6a 0x69 0x69 0x69 0x69 0x6d 0x6b 0x6a 0x6a 0x6b 0x6b 0x6d 0x6f 0x73 0x6f 0x6e 0x6e 0x6d 0x6b 0x6b 0x6b 0x6b 0x6b 0x6e 0x6d 0x6d 0x6b 0x6d 0x6d 0x6e 0x70 0x72 0x6e 0x6b 0x6b 0x6a 0x69 0x69 0x69 0x69 0x6b 0x6e 0x6d 0x6b 0x6b 0x6b 0x6d 0x6e 0x70 0x73 0x6e 0x6d 0x6d 0x6b 0x6b 0x6b 0x6a 0x6a 0x6f 0x6f 0x6e 0x6d 0x6d 0x6e 0x6e 0x6e 0x72 0x70 0x6e 0x6d 0x6b 0x6b 0x6a 0x6b 0x6a 0x69 0x6f 0x6d 0x6b 0x6b 0x6b 0x6b 0x6d 0x6d 0x6f 0x73 0x6f 0x6e 0x6e 0x6d 0x6b 0x6d 0x6b 0x6b 0x70 0x6d 0x6b 0x6b 0x6b 0x6b 0x6b 0x6d 0x70 0x72 0x6d 0x6b 0x6b 0x6a 0x69 0x6a 0x69 0x69 0x70 0x6b 0x6b 0x6b 0x6b 0x6b 0x6d 0x6d 0x70 0x73 0x6d 0x6b 0x6b 0x6a 0x6a 0x6a 0x6a 0x69 0x73 0x6e 0x6e 0x6d 0x6e 0x6e 0x6e 0x6f 0x73 0x70 0x6d 0x6b 0x6b 0x6b 0x6a 0x6a 0x6a 0x69 0x70 0x6b 0x6b 0x6b 0x6b 0x6b 0x6d 0x6d 0x70 0x70 0x6e 0x6e 0x6e 0x6d 0x6d 0x6d 0x6e 0x6b 0x72 0x6d 0x6d 0x6d 0x6d 0x6d 0x6d 0x6e 0x72 0x70 0x6d 0x6b 0x6b 0x6a 0x6a 0x6a 0x6b 0x69 0x70 0x6d 0x6d 0x6b 0x6b 0x6d 0x6e 0x6e 0x70 0x73 0x6e 0x6d 0x6d 0x6b 0x6b 0x6b 0x6e 0x6b 0x72 0x6e 0x6e 0x6d 0x6e 0x6e 0x6e 0x6f 0x73 0x70 0x6e 0x6d 0x6d 0x6b 0x6b 0x6b 0x6d 0x6a 0x70 0x6b 0x6b 0x6a 0x6a 0x6b 0x6b 0x6d 0x70 0x72 0x6e 0x6e 0x6e 0x6d 0x6d 0x6d 0x6d 0x6b 0x70 0x6e 0x6d 0x6b 0x6b 0x6d 0x6e 0x6e 0x72 0x70 0x6d 0x6b 0x6b 0x6a 0x6a 0x6a 0x6a 0x69 0x70 0x6e 0x6b 0x6b 0x6b 0x6d 0x6d 0x6e 0x72 0x72 0x6e 0x6d 0x6d 0x6b 0x6b 0x6b 0x6b 0x6e 0x72 0x6e 0x6e 0x6e 0x6e 0x6e 0x6f 0x6f 0x73 0x70 0x6d 0x6b 0x6b 0x6b 0x6b 0x6b 0x6b 0x6b 0x6f 0x6d 0x6b 0x6a 0x6b 0x6b 0x6d 0x6e 0x72 0x70 0x6e 0x6e 0x6e 0x6d 0x6d 0x6e 0x6d 0x6d 0x70 0x6d 0x6b 0x6b 0x6b 0x6d 0x6d 0x6e 0x73 0x70 0x6b 0x6b 0x6b 0x6a 0x6a 0x6b 0x6b 0x69 0x6f 0x6d 0x6d 0x6b 0x6d 0x6d 0x6e 0x6e 0x73 0x72 0x6d 0x6d 0x6d 0x6b 0x6b 0x6b 0x6d 0x6a 0x70 0x6e 0x6e 0x6e 0x6e 0x6f 0x70 0x70 0x75 0x6f 0x6d 0x6b 0x6b 0x6b 0x6a 0x6b 0x6b 0x69 0x6d 0x6a 0x6b 0x6b 0x6b 0x6d 0x6d 0x6e 0x73 0x6f 0x6e 0x6e 0x6e 0x6e 0x6e 0x6e 0x6e 0x6d 0x6e 0x6d 0x6d 0x6d 0x6e 0x6e 0x6e 0x70 0x74 0x6f 0x6d 0x6d 0x6b 0x6b 0x6b 0x6b 0x6d 0x6a 0x6d 0x6b 0x6b 0x6b 0x6d 0x6e 0x6e 0x6f 0x73 0x72 0x6e 0x6e 0x6e 0x6d 0x6d 0x6e 0x6f 0x6b 0x6e 0x6d 0x6e 0x6e 0x6e 0x6f 0x70 0x70 0x75 0x70 0x6e 0x6e 0x6d 0x6b 0x6b 0x6d 0x6e 0x6b 0x6b 0x6b 0x6b 0x6b 0x6b 0x6e 0x6e 0x6f 0x73 0x70 0x6f 0x6f 0x6e 0x6e 0x6e 0x6e 0x6f 0x6d 0x6e 0x6b 0x6d 0x6d 0x6e 0x6e 0x6f 0x70 0x75 0x70 0x6e 0x6b 0x6b 0x6b 0x6b 0x6b 0x6d 0x69 0x6d 0x6b 0x6b 0x6b 0x6d 0x6e 0x6e 0x70 0x74 0x72 0x6e 0x6e 0x6e 0x6d 0x6d 0x6e 0x6e 0x6b 0x6e 0x6d 0x6d 0x6e 0x6e 0x6f 0x70 0x72 0x77 0x6f 0x6e 0x6e 0x6d 0x6b 0x6b 0x6e 0x6e 0x6a 0x6b 0x6b 0x6a 0x6b 0x6b 0x6d 0x6e 0x70 0x74 0x70 0x6f 0x6f 0x6e 0x6e 0x6e 0x70 0x6f 0x6d 0x75 0x77 0x75 0x77 0x78 0x78 0x79 0x7c 0x84 0x6f 0x6e 0x6d 0x6d 0x6b 0x6b 0x6e 0x6d 0x6a 0x6a 0x6e 0x6f 0x6b 0x6b 0x6d 0x6d 0x6e 0x6f 0x6e 0x79 0x78 0x78 0x78 0x78 0x7a 0x7a 0x7a 0x78 0x78 0x79 0x75 0x75 0x75 0x75 0x77 0x74 0x13a 0x13a 0x13a>;
					PS_Config_Lmt_FW_Diff_N = <0xffffffce 0xffffffce 0xffffffce 0xffffffce 0xffffffce 0xffffffce 0xffffffce 0xffffffce 0xffff0001 0xffff0001 0xffffffce 0xffffffce 0xffffffce 0xffffffce 0xffffffce 0xffffffce 0xffffffce 0xffffffce 0xffffffce 0xffffffce 0xffffffce 0xffffffce 0xffffffce 0xffffffce 0xffffffce 0xffffffce 0xffffffce 0xffffffce 0xffffffce 0xffffffce 0xffffffce 0xffffffce 0xffffffce 0xffffffce 0xffffffce 0xffffffce 0xffffffce 0xffffffce 0xffffffce 0xffffffce 0xffffffce 0xffffffce 0xffffffce 0xffffffce 0xffffffce 0xffffffce 0xffffffce 0xffffffce 0xffffffce 0xffffffce 0xffffffce 0xffffffce 0xffffffce 0xffffffce 0xffffffce 0xffffffce 0xffffffce 0xffffffce 0xffffffce 0xffffffce 0xffffffce 0xffffffce 0xffffffce 0xffffffce 0xffffffce 0xffffffce 0xffffffce 0xffffffce 0xffffffce 0xffffffce 0xffffffce 0xffffffce 0xffffffce 0xffffffce 0xffffffce 0xffffffce 0xffffffce 0xffffffce 0xffffffce 0xffffffce 0xffffffce 0xffffffce 0xffffffce 0xffffffce 0xffffffce 0xffffffce 0xffffffce 0xffffffce 0xffffffce 0xffffffce 0xffffffce 0xffffffce 0xffffffce 0xffffffce 0xffffffce 0xffffffce 0xffffffce 0xffffffce 0xffffffce 0xffffffce 0xffffffce 0xffffffce 0xffffffce 0xffffffce 0xffffffce 0xffffffce 0xffffffce 0xffffffce 0xffffffce 0xffffffce 0xffffffce 0xffffffce 0xffffffce 0xffffffce 0xffffffce 0xffffffce 0xffffffce 0xffffffce 0xffffffce 0xffffffce 0xffffffce 0xffffffce 0xffffffce 0xffffffce 0xffffffce 0xffffffce 0xffffffce 0xffffffce 0xffffffce 0xffffffce 0xffffffce 0xffffffce 0xffffffce 0xffffffce 0xffffffce 0xffffffce 0xffffffce 0xffffffce 0xffffffce 0xffffffce 0xffffffce 0xffffffce 0xffffffce 0xffffffce 0xffffffce 0xffffffce 0xffffffce 0xffffffce 0xffffffce 0xffffffce 0xffffffce 0xffffffce 0xffffffce 0xffffffce 0xffffffce 0xffffffce 0xffffffce 0xffffffce 0xffffffce 0xffffffce 0xffffffce 0xffffffce 0xffffffce 0xffffffce 0xffffffce 0xffffffce 0xffffffce 0xffffffce 0xffffffce 0xffffffce 0xffffffce 0xffffffce 0xffffffce 0xffffffce 0xffffffce 0xffffffce 0xffffffce 0xffffffce 0xffffffce 0xffffffce 0xffffffce 0xffffffce 0xffffffce 0xffffffce 0xffffffce 0xffffffce 0xffffffce 0xffffffce 0xffffffce 0xffffffce 0xffffffce 0xffffffce 0xffffffce 0xffffffce 0xffffffce 0xffffffce 0xffffffce 0xffffffce 0xffffffce 0xffffffce 0xffffffce 0xffffffce 0xffffffce 0xffffffce 0xffffffce 0xffffffce 0xffffffce 0xffffffce 0xffffffce 0xffffffce 0xffffffce 0xffffffce 0xffffffce 0xffffffce 0xffffffce 0xffffffce 0xffffffce 0xffffffce 0xffffffce 0xffffffce 0xffffffce 0xffffffce 0xffffffce 0xffffffce 0xffffffce 0xffffffce 0xffffffce 0xffffffce 0xffffffce 0xffffffce 0xffffffce 0xffffffce 0xffffffce 0xffffffce 0xffffffce 0xffffffce 0xffffffce 0xffffffce 0xffffffce 0xffffffce 0xffffffce 0xffffffce 0xffffffce 0xffffffce 0xffffffce 0xffffffce 0xffffffce 0xffffffce 0xffffffce 0xffffffce 0xffffffce 0xffffffce 0xffffffce 0xffffffce 0xffffffce 0xffffffce 0xffffffce 0xffffffce 0xffffffce 0xffffffce 0xffffffce 0xffffffce 0xffffffce 0xffffffce 0xffffffce 0xffffffce 0xffffffce 0xffffffce 0xffffffce 0xffffffce 0xffffffce 0xffffffce 0xffffffce 0xffffffce 0xffffffce 0xffffffce 0xffffffce 0xffffffce 0xffffffce 0xffffffce 0xffffffce 0xffffffce 0xffffffce 0xffffffce 0xffffffce 0xffffffce 0xffffffce 0xffffffce 0xffffffce 0xffffffce 0xffffffce 0xffffffce 0xffffffce 0xffffffce 0xffffffce 0xffffffce 0xffffffce 0xffffffce 0xffffffce 0xffffffce 0xffffffce 0xffffffce 0xffffffce 0xffffffce 0xffffffce 0xffffffce 0xffffffce 0xffffffce 0xffffffce 0xffffffce 0xffffffce 0xffffffce 0xffffffce 0xffffffce 0xffffffce 0xffffffce 0xffffffce 0xffffffce 0xffffffce 0xffffffce 0xffffffce 0xffffffce 0xffffffce 0xffffffce 0xffffffce 0xffffffce 0xffffffce 0xffffffce 0xffffffce 0xffffffce 0xffffffce 0xffffffce 0xffffffce 0xffffffce 0xffffffce 0xffffffce 0xffffffce 0xffffffce 0xffffffce 0xffffffce 0xffffffce 0xffffffce 0xffffffce 0xffffffce 0xffffffce 0xffffffce 0xffffffce 0xffffffce 0xffffffce 0xffffffce 0xffffffce 0xffffffce 0xffffffce 0xffffffce 0xffffffce 0xffffffce 0xffffffce 0xffffffce 0xffffffce 0xffffffce 0xffffffce 0xffffffce 0xffffffce 0xffffffce 0xffffffce 0xffffffce 0xffffffce 0xffffffce 0xffffffce 0xffffffce 0xffffffce 0xffffffce 0xffffffce 0xffffffce 0xffffffce 0xffffffce 0xffffffce 0xffffffce 0xffffffce 0xffffffce 0xffffffce 0xffffffce 0xffffffce 0xffffffce 0xffffffce 0xffffffce 0xffffffce 0xffffffce 0xffffffce 0xffffffce 0xffffffce 0xffffffce 0xffffffce 0xffffffce 0xffffffce 0xffffffce 0xffffffce 0xffffffce 0xffffffce 0xffffffce 0xffffffce 0xffffffce 0xffffffce 0xffffffce 0xffffffce 0xffffffce 0xffffffce 0xffffffce 0xffffffce 0xffffffce 0xffffffce 0xffffffce 0xffffffce 0xffffffce 0xffffffce 0xffffffce 0xffffffce 0xffffffce 0xffffffce 0xffffffce 0xffffffce 0xffffffce 0xffffffce 0xffffffce 0xffffffce 0xffffffce 0xffffffce 0xffffffce 0xffffffce 0xffffffce 0xffffffce 0xffffffce 0xffffffce 0xffffffce 0xffffffce 0xffffffce 0xffffffce 0xffffffce 0xffffffce 0xffffffce 0xffffffce 0xffffffce 0xffffffce 0xffffffce 0xffffffce 0xffffffce 0xffffffce 0xffffffce 0xffffffce 0xffffffce 0xffffffce 0xffffffce 0xffffffce 0xffffffce 0xffffffce 0xffffffce 0xffffffce 0xffffffce 0xffffffce 0xffffffce 0xffffffce 0xffffffce 0xffffffce 0xffffffce 0xffffffce 0xffffffce 0xffffffce 0xffffffce 0xffffffce 0xffffffce 0xffffffce 0xffffffce 0xffffffce 0xffffffce 0xffffffce 0xffffffce 0xffffffce 0xffffffce 0xffffffce 0xffffffce 0xffffffce 0xffffffce 0xffffffce 0xffffffce 0xffffffce 0xffffffce 0xffffffce 0xffffffce 0xffffffce 0xffffffce 0xffffffce 0xffffffce 0xffffffce 0xffffffce 0xffffffce 0xffffffce 0xffffffce 0xffffffce 0xffffffce 0xffffffce 0xffffffce 0xffffffce 0xffffffce 0xffffffce 0xffffffce 0xffffffce 0xffffffce 0xffffffce 0xffffffce 0xffffffce 0xffffffce 0xffffffce 0xffffffce 0xffffffce 0xffffffce 0xffffffce 0xffffffce 0xffffffce 0xffffffce 0xffffffce 0xffffffce 0xffffffce 0xffffffce 0xffffffce 0xffffffce 0xffffffce 0xffffffce 0xffffffce 0xffffffce 0xffffffce 0xffffffce 0xffffffce 0xffffffce 0xffffffce 0xffffffce 0xffffffce 0xffffffce 0xffffffce 0xffffffce 0xffffffce 0xffffffce 0xffffffce 0xffffffce 0xffffffce 0xffffffce 0xffffffce 0xffffffce 0xffffffce 0xffffffce 0xffffffce 0xffffffce 0xffffffce 0xffffffce 0xffffffce 0xffffffce 0xffffffce 0xffffffce 0xffffffce 0xffffffce 0xffffffce 0xffffffce 0xffffffce 0xffffffce 0xffffffce 0xffffffce 0xffffffce 0xffffffce 0xffffffce 0xffffffce 0xffffffce 0xffffffce 0xffffffce 0xffffffce 0xffffffce 0xffffffce 0xffffffce 0xffffffce 0xffffffce 0xffffffce 0xffffffce 0xffffffce 0xffffffce 0xffffffce 0xffffffce 0xffffffce 0xffffffce 0xffffffce 0xffffffce 0xffffffce 0xffffffce 0xffffffce 0xffffffce 0xffffffce 0xffffffce 0xffffffce 0xffffffce 0xffffffce 0xffffffce 0xffffffce 0xffffffce 0xffffffce 0xffffffce 0xffffffce 0xffffffce 0xffffffce 0xffffffce 0xffffffce 0xffffffce 0xffffffce 0xffffffce 0xffffffce 0xffffffce 0xffffffce 0xffffffce 0xffffffce 0xffffffce 0xffffffce 0xffffffce 0xffffffce 0xffffffce 0xffffffce 0xffffffce 0xffffffce 0xffffffce 0xffffffce 0xffffffce 0xffffffce 0xffffffce 0xffffffce 0xffffffce 0xffffffce 0xffffffce 0xffffffce 0xffffffce 0xffffffce 0xffffffce 0xffffffce 0xffffffce 0xffffffce 0xffffffce 0xffffffce 0xffffffce 0xffffffce 0xffffffce 0xffffffce 0xffffffce 0xffffffce 0xffffffce 0xffffffb5 0xffffffb5 0xffffffb5>;
					PS_Config_Lmt_FW_Diff_P = <0x32 0x32 0x32 0x32 0x32 0x32 0x32 0x32 0xffff 0xffff 0x32 0x32 0x32 0x32 0x32 0x32 0x32 0x32 0x32 0x32 0x32 0x32 0x32 0x32 0x32 0x32 0x32 0x32 0x32 0x32 0x32 0x32 0x32 0x32 0x32 0x32 0x32 0x32 0x32 0x32 0x32 0x32 0x32 0x32 0x32 0x32 0x32 0x32 0x32 0x32 0x32 0x32 0x32 0x32 0x32 0x32 0x32 0x32 0x32 0x32 0x32 0x32 0x32 0x32 0x32 0x32 0x32 0x32 0x32 0x32 0x32 0x32 0x32 0x32 0x32 0x32 0x32 0x32 0x32 0x32 0x32 0x32 0x32 0x32 0x32 0x32 0x32 0x32 0x32 0x32 0x32 0x32 0x32 0x32 0x32 0x32 0x32 0x32 0x32 0x32 0x32 0x32 0x32 0x32 0x32 0x32 0x32 0x32 0x32 0x32 0x32 0x32 0x32 0x32 0x32 0x32 0x32 0x32 0x32 0x32 0x32 0x32 0x32 0x32 0x32 0x32 0x32 0x32 0x32 0x32 0x32 0x32 0x32 0x32 0x32 0x32 0x32 0x32 0x32 0x32 0x32 0x32 0x32 0x32 0x32 0x32 0x32 0x32 0x32 0x32 0x32 0x32 0x32 0x32 0x32 0x32 0x32 0x32 0x32 0x32 0x32 0x32 0x32 0x32 0x32 0x32 0x32 0x32 0x32 0x32 0x32 0x32 0x32 0x32 0x32 0x32 0x32 0x32 0x32 0x32 0x32 0x32 0x32 0x32 0x32 0x32 0x32 0x32 0x32 0x32 0x32 0x32 0x32 0x32 0x32 0x32 0x32 0x32 0x32 0x32 0x32 0x32 0x32 0x32 0x32 0x32 0x32 0x32 0x32 0x32 0x32 0x32 0x32 0x32 0x32 0x32 0x32 0x32 0x32 0x32 0x32 0x32 0x32 0x32 0x32 0x32 0x32 0x32 0x32 0x32 0x32 0x32 0x32 0x32 0x32 0x32 0x32 0x32 0x32 0x32 0x32 0x32 0x32 0x32 0x32 0x32 0x32 0x32 0x32 0x32 0x32 0x32 0x32 0x32 0x32 0x32 0x32 0x32 0x32 0x32 0x32 0x32 0x32 0x32 0x32 0x32 0x32 0x32 0x32 0x32 0x32 0x32 0x32 0x32 0x32 0x32 0x32 0x32 0x32 0x32 0x32 0x32 0x32 0x32 0x32 0x32 0x32 0x32 0x32 0x32 0x32 0x32 0x32 0x32 0x32 0x32 0x32 0x32 0x32 0x32 0x32 0x32 0x32 0x32 0x32 0x32 0x32 0x32 0x32 0x32 0x32 0x32 0x32 0x32 0x32 0x32 0x32 0x32 0x32 0x32 0x32 0x32 0x32 0x32 0x32 0x32 0x32 0x32 0x32 0x32 0x32 0x32 0x32 0x32 0x32 0x32 0x32 0x32 0x32 0x32 0x32 0x32 0x32 0x32 0x32 0x32 0x32 0x32 0x32 0x32 0x32 0x32 0x32 0x32 0x32 0x32 0x32 0x32 0x32 0x32 0x32 0x32 0x32 0x32 0x32 0x32 0x32 0x32 0x32 0x32 0x32 0x32 0x32 0x32 0x32 0x32 0x32 0x32 0x32 0x32 0x32 0x32 0x32 0x32 0x32 0x32 0x32 0x32 0x32 0x32 0x32 0x32 0x32 0x32 0x32 0x32 0x32 0x32 0x32 0x32 0x32 0x32 0x32 0x32 0x32 0x32 0x32 0x32 0x32 0x32 0x32 0x32 0x32 0x32 0x32 0x32 0x32 0x32 0x32 0x32 0x32 0x32 0x32 0x32 0x32 0x32 0x32 0x32 0x32 0x32 0x32 0x32 0x32 0x32 0x32 0x32 0x32 0x32 0x32 0x32 0x32 0x32 0x32 0x32 0x32 0x32 0x32 0x32 0x32 0x32 0x32 0x32 0x32 0x32 0x32 0x32 0x32 0x32 0x32 0x32 0x32 0x32 0x32 0x32 0x32 0x32 0x32 0x32 0x32 0x32 0x32 0x32 0x32 0x32 0x32 0x32 0x32 0x32 0x32 0x32 0x32 0x32 0x32 0x32 0x32 0x32 0x32 0x32 0x32 0x32 0x32 0x32 0x32 0x32 0x32 0x32 0x32 0x32 0x32 0x32 0x32 0x32 0x32 0x32 0x32 0x32 0x32 0x32 0x32 0x32 0x32 0x32 0x32 0x32 0x32 0x32 0x32 0x32 0x32 0x32 0x32 0x32 0x32 0x32 0x32 0x32 0x32 0x32 0x32 0x32 0x32 0x32 0x32 0x32 0x32 0x32 0x32 0x32 0x32 0x32 0x32 0x32 0x32 0x32 0x32 0x32 0x32 0x32 0x32 0x32 0x32 0x32 0x32 0x32 0x32 0x32 0x32 0x32 0x32 0x32 0x32 0x32 0x32 0x32 0x32 0x32 0x32 0x32 0x32 0x32 0x32 0x32 0x32 0x32 0x32 0x32 0x32 0x32 0x32 0x32 0x32 0x32 0x32 0x32 0x32 0x32 0x32 0x32 0x32 0x32 0x32 0x32 0x32 0x32 0x32 0x32 0x32 0x32 0x32 0x32 0x32 0x32 0x32 0x32 0x32 0x32 0x32 0x32 0x32 0x32 0x32 0x32 0x32 0x32 0x32 0x32 0x32 0x32 0x32 0x32 0x32 0x32 0x32 0x32 0x32 0x32 0x32 0x32 0x32 0x32 0x32 0x32 0x32 0x32 0x32 0x32 0x32 0x32 0x32 0x32 0x32 0x32 0x32 0x32 0x32 0x32 0x32 0x32 0x4b 0x4b 0x4b>;
					PS_Config_Lmt_FW_Rawdata_N = <0x3b5 0x3bc 0x3ba 0x3b9 0x3c5 0x3b4 0x3b2 0x3b7 0xffff0001 0xffff0001 0x3c2 0x3c0 0x3be 0x3ba 0x3c3 0x3b6 0x3bf 0x3b7 0x3c0 0x3b9 0x3c1 0x3b6 0x3b7 0x3b8 0x3b5 0x3b9 0x3b8 0x3ba 0x3b3 0x3b5 0x3b4 0x3b3 0x3b7 0x3b4 0x3b1 0x3c6 0x3b8 0x3b5 0x3b6 0x3b4 0x3be 0x3c1 0x3ba 0x3bb 0x3b5 0x3c0 0x3ba 0x3b1 0x3bd 0x3c0 0x3b1 0x3b9 0x3bb 0x3bf 0x3b8 0x3b3 0x3c1 0x3b2 0x3af 0x3c0 0x3bf 0x3bc 0x3ba 0x3b7 0x3b7 0x3c3 0x3b1 0x3b4 0x3be 0x3be 0x3b8 0x3b8 0x3c0 0x3b3 0x3c3 0x3bc 0x3b2 0x3b7 0x3cd 0x3cd 0x3bf 0x3bc 0x3b2 0x3bd 0x3b7 0x3b3 0x3c0 0x3bd 0x3af 0x3b1 0x3c1 0x3c6 0x3b7 0x3ab 0x3be 0x3b9 0x3b4 0x3b9 0x3b2 0x3b3 0x3b7 0x3be 0x3b0 0x3a8 0x3b5 0x3be 0x3c1 0x3ba 0x3bd 0x3b8 0x3b8 0x3aa 0x3c4 0x3c0 0x3c1 0x3bd 0x3b8 0x3b5 0x3b3 0x3be 0x3b4 0x3ab 0x3b8 0x3c1 0x3b8 0x3b8 0x3b3 0x3b4 0x3c4 0x3bd 0x3b0 0x3b4 0x3b8 0x3c8 0x3c4 0x3bb 0x3bb 0x3bb 0x3bd 0x3b8 0x3c3 0x3c1 0x3b2 0x3b8 0x3c5 0x3bb 0x3b4 0x3bc 0x3b8 0x3b2 0x3b6 0x3b8 0x3bd 0x3b8 0x3b4 0x3ba 0x3b5 0x3b3 0x3bc 0x3bb 0x3ba 0x3bc 0x3b3 0x3c1 0x3b3 0x3b4 0x3bd 0x3b7 0x3be 0x3b4 0x3b0 0x3be 0x3ab 0x3af 0x3bd 0x3be 0x3b5 0x3ae 0x3b4 0x3c6 0x3b8 0x3ba 0x3b7 0x3bb 0x3bd 0x3be 0x3c0 0x3bb 0x3bb 0x3b4 0x3b4 0x3bd 0x3a8 0x3a7 0x3bd 0x3c3 0x3be 0x3b1 0x3b3 0x3ba 0x3ae 0x3b4 0x3c2 0x3b8 0x3bd 0x3bb 0x3b3 0x3c3 0x3bb 0x3bc 0x3bd 0x3be 0x3bb 0x3b9 0x3ba 0x3bd 0x3bb 0x3be 0x3bb 0x3b7 0x3af 0x3c3 0x3b5 0x3b7 0x3c1 0x3be 0x3bd 0x3ba 0x3bd 0x3c0 0x3ae 0x3af 0x3b8 0x3c1 0x3be 0x3b8 0x3b5 0x3b8 0x3bc 0x3b7 0x3bb 0x3b8 0x3b2 0x3c8 0x3b8 0x3b9 0x3b4 0x3b6 0x3b7 0x3c3 0x3b2 0x3c1 0x3c0 0x3b5 0x3b4 0x3c0 0x3c0 0x3c0 0x3be 0x3b4 0x3ba 0x3c4 0x3ba 0x3be 0x3b7 0x3b5 0x3bb 0x3bb 0x3b8 0x3bb 0x3b7 0x3bf 0x3b1 0x3ab 0x3bd 0x3c4 0x3be 0x3b6 0x3b3 0x3c3 0x3c0 0x3b8 0x3b2 0x3b4 0x3c0 0x3c4 0x3ac 0x3ba 0x3bf 0x3b5 0x3bd 0x3ba 0x3b1 0x3b4 0x3b2 0x3bf 0x3c2 0x3c0 0x3ba 0x3b2 0x3ac 0x3b1 0x3c0 0x3c1 0x3af 0x3bb 0x3b3 0x3bd 0x3bd 0x3c0 0x3b1 0x3b5 0x3b4 0x3b8 0x3bd 0x3ba 0x3bf 0x3b9 0x3bb 0x3bd 0x3af 0x3b2 0x3c0 0x3b4 0x3c5 0x3b4 0x3b5 0x3b1 0x3bd 0x3bb 0x3be 0x3be 0x3ba 0x3ba 0x3bb 0x3b7 0x3b7 0x3b5 0x3bd 0x3c0 0x3bd 0x3bd 0x3b7 0x3ba 0x3b5 0x3b4 0x3b9 0x3ba 0x3bb 0x3b1 0x3b7 0x3bc 0x3bb 0x3b9 0x3b5 0x3bd 0x3b5 0x3ba 0x3b5 0x3b8 0x3c7 0x3ae 0x3be 0x3c1 0x3b6 0x3b7 0x3b7 0x3b7 0x3b4 0x3b9 0x3b8 0x3b5 0x3bb 0x3b8 0x3b9 0x3b2 0x3b6 0x3bf 0x3b3 0x3bd 0x3be 0x3b8 0x3b2 0x3b5 0x3b3 0x3b4 0x3bc 0x3b3 0x3ba 0x3b6 0x3b1 0x3b7 0x3ba 0x3b8 0x3b2 0x3c1 0x3c1 0x3b2 0x3be 0x3ba 0x3b1 0x3b1 0x3b6 0x3b3 0x3c0 0x3bc 0x3ae 0x3ae 0x3b1 0x3b5 0x3c2 0x3c1 0x3b5 0x3c1 0x3b8 0x3b9 0x3b5 0x3b1 0x3c5 0x3c1 0x3b4 0x3a8 0x3b6 0x3c7 0x3c9 0x3c6 0x3c4 0x3b8 0x3af 0x3b2 0x3c7 0x3b2 0x3b7 0x3b8 0x3ba 0x3b8 0x3b6 0x3b8 0x3b6 0x3b0 0x3bc 0x3b2 0x3b7 0x3bb 0x3c0 0x3b6 0x3b5 0x3b7 0x3b8 0x3c1 0x3c1 0x3bc 0x3b7 0x3b5 0x3b9 0x3b8 0x3b9 0x3b9 0x3b5 0x3bc 0x3af 0x3ba 0x3b2 0x3c3 0x3c3 0x3aa 0x3c4 0x3b5 0x3bd 0x3b2 0x3af 0x3b6 0x3c0 0x3b9 0x3b4 0x3b8 0x3b8 0x3b2 0x3b4 0x3b6 0x3b5 0x3ba 0x3be 0x3bb 0x3bc 0x3b0 0x3b9 0x3bb 0x3bd 0x3b9 0x3b5 0x3b0 0x3b7 0x3bb 0x3b2 0x3c2 0x3b6 0x3bf 0x3c1 0x3bf 0x3b7 0x3b8 0x3c3 0x3ae 0x3c0 0x3c0 0x3b9 0x3ba 0x3b3 0x3b5 0x3b9 0x3bb 0x3b7 0x3b9 0x3b2 0x3b4 0x3b8 0x3b2 0x3bc 0x3ba 0x3bb 0x3c3 0x3b6 0x3b3 0x3b7 0x3c0 0x3be 0x3c1 0x3be 0x3af 0x3ae 0x3bb 0x3b4 0x3b3 0x3b2 0x3bf 0x3be 0x3b8 0x3c4 0x3b8 0x3c6 0x3ac 0x3bb 0x3bd 0x3b3 0x3b8 0x3b3 0x3b4 0x3c7 0x3b2 0x3bb 0x3ba 0x3b5 0x3b9 0x3bd 0x3ba 0x3c0 0x3b2 0x3bb 0x3b7 0x3b0 0x3b7 0x3ba 0x3bf 0x3b1 0x3b7 0x3b4 0x3bd 0x3b9 0x3b9 0x3ba 0x3b6 0x3c1 0x3bd 0x3c1 0x3b2 0x3bc 0x3b4 0x3be 0x3bc 0x3b9 0x3b8 0x3b3 0x3b6 0x3bb 0x3b1 0x3b2 0x3b7 0x3af 0x3ba 0x3b7 0x3b2 0x3b7 0x3b8 0x3b7 0x3bb 0x3bb 0x3bd 0x3ba 0x3bb 0x3b7 0x3b6 0x3af 0x3ae 0x3b9 0x3ac 0x3af 0x3bb 0x3b5 0x3be 0x3c3 0x3ba 0x3bb 0x3c0 0x3b1 0x3ae 0x3bd 0x3bd 0x3b6 0x3b5 0x3b7 0x3c0 0x3b1 0x3ae 0x3b9 0x3af 0x3b1 0x3ba 0x3ba 0x3c3 0x3b8 0x3bc 0x3b7 0x3b5 0x3b4 0x3b5 0x3b8 0x3ba 0x3b8 0x3c0 0x3be 0x3b8 0x3b1 0x3ac 0x3b2 0x3ab 0x3bb 0x3b1 0xf0 0xf0 0xf0>;
					PS_Config_Lmt_FW_Rawdata_P = <0x8a8 0x8b7 0x8b3 0x8b0 0x8cc 0x8a5 0x89f 0x8ab 0xffff 0xffff 0x8c5 0x8c1 0x8bd 0x8b3 0x8c8 0x8a9 0x8be 0x8ac 0x8c1 0x8b0 0x8c2 0x8a9 0x8ab 0x8ad 0x8a6 0x8b0 0x8af 0x8b2 0x8a2 0x8a8 0x8a4 0x8a2 0x8ac 0x8a5 0x89e 0x8ce 0x8af 0x8a6 0x8a9 0x8a5 0x8bb 0x8c2 0x8b3 0x8b4 0x8a6 0x8c0 0x8b3 0x89e 0x8ba 0x8c0 0x89d 0x8b0 0x8b4 0x8be 0x8ad 0x8a2 0x8c2 0x8a1 0x898 0x8c1 0x8be 0x8b7 0x8b2 0x8ac 0x8ab 0x8c8 0x89e 0x8a5 0x8bb 0x8bd 0x8ad 0x8af 0x8c0 0x8a2 0x8c7 0x8b7 0x89f 0x8ab 0x8de 0x8de 0x8be 0x8b7 0x8a1 0x8ba 0x8ab 0x8a2 0x8c1 0x8ba 0x89a 0x89e 0x8c2 0x8ce 0x8ab 0x890 0x8bb 0x8b0 0x8a5 0x8b0 0x89f 0x8a2 0x8ab 0x8bd 0x89b 0x889 0x8a6 0x8bd 0x8c2 0x8b3 0x8b9 0x8af 0x8ad 0x88d 0x8cb 0x8c0 0x8c2 0x8b9 0x8af 0x8a8 0x8a2 0x8bb 0x8a5 0x88f 0x8ad 0x8c2 0x8ad 0x8af 0x8a2 0x8a4 0x8c9 0x8ba 0x89b 0x8a5 0x8af 0x8d3 0x8cb 0x8b4 0x8b6 0x8b4 0x8ba 0x8ad 0x8c8 0x8c2 0x8a1 0x8af 0x8cc 0x8b6 0x8a4 0x8b7 0x8ad 0x89f 0x8a9 0x8ad 0x8ba 0x8af 0x8a4 0x8b3 0x8a8 0x8a2 0x8b7 0x8b6 0x8b3 0x8b7 0x8a2 0x8c4 0x8a2 0x8a5 0x8ba 0x8ac 0x8bb 0x8a5 0x89b 0x8bb 0x88f 0x89a 0x8b9 0x8bd 0x8a8 0x897 0x8a5 0x8ce 0x8af 0x8b3 0x8ac 0x8b6 0x8b9 0x8bd 0x8c1 0x8b6 0x8b4 0x8a4 0x8a5 0x8ba 0x888 0x886 0x8b9 0x8c7 0x8bb 0x89d 0x8a2 0x8b2 0x897 0x8a5 0x8c5 0x8ad 0x8ba 0x8b4 0x8a2 0x8c8 0x8b4 0x8b7 0x8b9 0x8bb 0x8b6 0x8b0 0x8b3 0x8b9 0x8b4 0x8bb 0x8b4 0x8ab 0x898 0x8c7 0x8a6 0x8ac 0x8c4 0x8bb 0x8b9 0x8b3 0x8ba 0x8c1 0x897 0x89a 0x8ad 0x8c2 0x8bd 0x8af 0x8a8 0x8af 0x8b7 0x8ab 0x8b4 0x8af 0x89f 0x8d3 0x8af 0x8b0 0x8a4 0x8a9 0x8ab 0x8c8 0x8a1 0x8c2 0x8c0 0x8a6 0x8a5 0x8c0 0x8c1 0x8c0 0x8bb 0x8a5 0x8b3 0x8cb 0x8b2 0x8bb 0x8ac 0x8a8 0x8b6 0x8b4 0x8ad 0x8b6 0x8ab 0x8be 0x89d 0x88f 0x8ba 0x8c9 0x8bd 0x8a9 0x8a2 0x8c7 0x8c1 0x8ad 0x89f 0x8a4 0x8c1 0x8cb 0x893 0x8b3 0x8be 0x8a6 0x8b9 0x8b3 0x89d 0x8a5 0x89f 0x8be 0x8c5 0x8c0 0x8b3 0x8a1 0x893 0x89e 0x8c0 0x8c2 0x898 0x8b6 0x8a2 0x8ba 0x8b9 0x8c0 0x89e 0x8a8 0x8a4 0x8ad 0x8b9 0x8b2 0x8be 0x8b0 0x8b6 0x8b9 0x898 0x8a1 0x8c1 0x8a4 0x8cc 0x8a5 0x8a6 0x89e 0x8ba 0x8b6 0x8bd 0x8bd 0x8b2 0x8b3 0x8b6 0x8ab 0x8ac 0x8a6 0x8ba 0x8c0 0x8ba 0x8b9 0x8ac 0x8b2 0x8a8 0x8a5 0x8b0 0x8b3 0x8b6 0x89d 0x8ab 0x8b7 0x8b4 0x8b0 0x8a6 0x8ba 0x8a8 0x8b2 0x8a6 0x8af 0x8d2 0x897 0x8bb 0x8c2 0x8a9 0x8ac 0x8ac 0x8ab 0x8a5 0x8b0 0x8ad 0x8a8 0x8b6 0x8af 0x8b0 0x89f 0x8a9 0x8be 0x8a2 0x8ba 0x8bb 0x8af 0x89f 0x8a6 0x8a2 0x8a4 0x8b7 0x8a2 0x8b3 0x8a9 0x89e 0x8ab 0x8b2 0x8af 0x89f 0x8c4 0x8c4 0x8a1 0x8bd 0x8b3 0x89e 0x89d 0x8a9 0x8a2 0x8c1 0x8b7 0x897 0x896 0x89e 0x8a6 0x8c5 0x8c2 0x8a6 0x8c2 0x8af 0x8b0 0x8a8 0x89e 0x8cc 0x8c2 0x8a5 0x889 0x8a9 0x8d2 0x8d5 0x8ce 0x8c9 0x8ad 0x89a 0x8a1 0x8d2 0x89f 0x8ab 0x8ad 0x8b3 0x8af 0x8a9 0x8af 0x8a9 0x89b 0x8b7 0x8a1 0x8ac 0x8b6 0x8c1 0x8a9 0x8a6 0x8ab 0x8ad 0x8c2 0x8c2 0x8b7 0x8ac 0x8a6 0x8b0 0x8af 0x8b0 0x8b0 0x8a8 0x8b7 0x898 0x8b3 0x89f 0x8c8 0x8c7 0x88d 0x8c9 0x8a8 0x8ba 0x8a1 0x89a 0x8a9 0x8c1 0x8b0 0x8a5 0x8ad 0x8ad 0x8a1 0x8a4 0x8a9 0x8a8 0x8b2 0x8bb 0x8b6 0x8b7 0x89b 0x8b0 0x8b6 0x8b9 0x8b0 0x8a8 0x89b 0x8ac 0x8b4 0x8a1 0x8c5 0x8a9 0x8be 0x8c2 0x8be 0x8ab 0x8ad 0x8c7 0x897 0x8c1 0x8c1 0x8b0 0x8b3 0x8a2 0x8a8 0x8b0 0x8b4 0x8ac 0x8b0 0x8a1 0x8a5 0x8ad 0x8a1 0x8b7 0x8b2 0x8b6 0x8c7 0x8a9 0x8a2 0x8ac 0x8c1 0x8bb 0x8c2 0x8bd 0x898 0x897 0x8b6 0x8a4 0x8a2 0x8a1 0x8be 0x8bb 0x8af 0x8cb 0x8af 0x8ce 0x893 0x8b6 0x8ba 0x8a2 0x8ad 0x8a2 0x8a4 0x8d0 0x8a1 0x8b4 0x8b3 0x8a8 0x8b0 0x8b9 0x8b3 0x8c0 0x89f 0x8b4 0x8ab 0x89b 0x8ac 0x8b3 0x8be 0x89d 0x8ab 0x8a4 0x8ba 0x8b0 0x8b0 0x8b2 0x8a9 0x8c4 0x8b9 0x8c2 0x89f 0x8b7 0x8a4 0x8bd 0x8b7 0x8b0 0x8ad 0x8a2 0x8a9 0x8b6 0x89d 0x89f 0x8ac 0x89a 0x8b2 0x8ab 0x8a1 0x8ab 0x8ad 0x8ac 0x8b6 0x8b6 0x8ba 0x8b3 0x8b6 0x8ab 0x8a9 0x89a 0x897 0x8b0 0x891 0x898 0x8b4 0x8a8 0x8bb 0x8c7 0x8b3 0x8b6 0x8c1 0x89e 0x897 0x8ba 0x8ba 0x8a9 0x8a6 0x8ab 0x8c1 0x89d 0x897 0x8b0 0x89a 0x89e 0x8b3 0x8b3 0x8c7 0x8af 0x8b7 0x8ab 0x8a6 0x8a4 0x8a8 0x8af 0x8b2 0x8ad 0x8c0 0x8bb 0x8ad 0x89e 0x891 0x8a1 0x890 0x8b4 0x89e 0x780 0x780 0x780>;
					PS_Config_Lmt_Open_Rawdata_N = <0x450 0x68b 0x6cf 0x6d1 0x6d3 0x6ca 0x6ce 0x675 0xffff0001 0xffff0001 0x679 0x6d8 0x6d4 0x6d9 0x6df 0x6ea 0x6a4 0x45f 0x663 0x6c0 0x6be 0x6bf 0x6c1 0x6ba 0x6be 0x6b3 0x682 0x699 0x6cb 0x6d7 0x6d2 0x6d6 0x6dd 0x6e8 0x6ed 0x67c 0x6da 0x6c7 0x6c5 0x6c6 0x6c7 0x6c1 0x6c5 0x6ba 0x6b0 0x6c5 0x6cc 0x6d8 0x6d5 0x6d8 0x6e0 0x6ea 0x6ed 0x6f1 0x6cb 0x6c9 0x6c8 0x6ca 0x6ca 0x6c4 0x6c6 0x6ba 0x6b2 0x6ca 0x6d2 0x6dd 0x6da 0x6dd 0x6e5 0x6ed 0x6f3 0x6f3 0x6cf 0x6c9 0x6ca 0x6ca 0x6ca 0x6c5 0x6c7 0x6bc 0x6b2 0x6ce 0x6d5 0x6de 0x6dd 0x6e1 0x6e8 0x6f0 0x6f5 0x6f5 0x6d2 0x6d1 0x6d2 0x6d2 0x6d1 0x6cc 0x6ce 0x6c2 0x6ba 0x6cf 0x6d7 0x6df 0x6de 0x6e2 0x6e8 0x6f0 0x6f5 0x6f4 0x6d2 0x6d1 0x6d1 0x6d1 0x6d0 0x6cb 0x6cd 0x6c1 0x6bb 0x6ca 0x6d2 0x6da 0x6da 0x6de 0x6e5 0x6eb 0x6f0 0x6ec 0x6d9 0x6ce 0x6cf 0x6cd 0x6ce 0x6c9 0x6ca 0x6bd 0x6b9 0x6d5 0x6dd 0x6df 0x6dc 0x6e5 0x6eb 0x6f0 0x6f7 0x6f2 0x6d8 0x6cc 0x6cd 0x6cc 0x6cd 0x6c8 0x6ca 0x6bc 0x6b9 0x6d8 0x6e0 0x6e4 0x6e0 0x6e9 0x6f0 0x6f5 0x6f8 0x6f3 0x6d6 0x6cf 0x6d0 0x6ce 0x6cf 0x6ca 0x6cc 0x6c0 0x6bb 0x6d5 0x6dc 0x6e0 0x6dd 0x6e5 0x6ec 0x6f0 0x6f4 0x6ed 0x6d2 0x6cf 0x6d1 0x6ce 0x6ce 0x6c9 0x6ca 0x6c0 0x6ba 0x6d3 0x6d8 0x6dd 0x6da 0x6e2 0x6e8 0x6ed 0x6f0 0x6e9 0x6d5 0x6c9 0x6cc 0x6c9 0x6c9 0x6c4 0x6c5 0x6bb 0x6b6 0x6d3 0x6d8 0x6dc 0x6db 0x6e3 0x6e7 0x6eb 0x6f0 0x6e8 0x6d3 0x6c8 0x6cb 0x6c7 0x6c9 0x6c4 0x6c5 0x6bb 0x6b6 0x6d2 0x6d8 0x6dd 0x6da 0x6e2 0x6e6 0x6eb 0x6ed 0x6e4 0x6cc 0x6cc 0x6ce 0x6ca 0x6ca 0x6c5 0x6c6 0x6bf 0x6b8 0x6d6 0x6db 0x6e0 0x6df 0x6e7 0x6ea 0x6ee 0x6ef 0x6e7 0x6cb 0x6c6 0x6cc 0x6c7 0x6c8 0x6c2 0x6c5 0x6bf 0x6b7 0x6cf 0x6d3 0x6da 0x6d8 0x6e0 0x6e3 0x6e8 0x6e8 0x6e0 0x6cc 0x6c7 0x6cd 0x6c8 0x6c9 0x6c5 0x6c9 0x6c3 0x6ba 0x6cf 0x6d3 0x6d8 0x6d8 0x6e0 0x6e2 0x6e8 0x6e5 0x6dd 0x6c9 0x6bf 0x6c5 0x6c0 0x6c1 0x6bc 0x6c1 0x6bf 0x6b2 0x6c9 0x6cd 0x6d2 0x6d2 0x6d9 0x6da 0x6e0 0x6df 0x6d6 0x6ca 0x6b9 0x6bf 0x6ba 0x6ba 0x6b5 0x6ba 0x6b7 0x6ac 0x6c9 0x6cd 0x6d2 0x6d2 0x6d8 0x6d9 0x6df 0x6dd 0x6d7 0x6c0 0x6bc 0x6bf 0x6bb 0x6bb 0x6b6 0x6b9 0x6b6 0x6a8 0x6c7 0x6cb 0x6cf 0x6cf 0x6d5 0x6d7 0x6dc 0x6d8 0x6ce 0x6b7 0x6b6 0x6ba 0x6b6 0x6b6 0x6b0 0x6b4 0x6b2 0x6aa 0x6c1 0x6c5 0x6ca 0x6ca 0x6cf 0x6cf 0x6d5 0x6d1 0x6ca 0x6ba 0x6b2 0x6b5 0x6b1 0x6b0 0x6ab 0x6af 0x6ac 0x6a6 0x6c4 0x6c6 0x6cd 0x6cb 0x6d1 0x6d1 0x6d6 0x6d4 0x6cc 0x6b5 0x6b0 0x6b4 0x6af 0x6af 0x6aa 0x6b0 0x6ab 0x6a4 0x6bf 0x6c1 0x6c8 0x6c7 0x6cc 0x6cc 0x6d0 0x6cf 0x6c7 0x6b1 0x6ac 0x6af 0x6ac 0x6aa 0x6a6 0x6ac 0x6a8 0x6a0 0x6bd 0x6bf 0x6c6 0x6c5 0x6c9 0x6ca 0x6cd 0x6ca 0x6c1 0x6af 0x6a7 0x6aa 0x6a5 0x6a4 0x6a0 0x6a6 0x6a2 0x69a 0x6b7 0x6ba 0x6c1 0x6bf 0x6c4 0x6c3 0x6c7 0x6c5 0x6bb 0x618 0x606 0x60a 0x609 0x607 0x601 0x605 0x601 0x5fd 0x619 0x619 0x622 0x621 0x626 0x628 0x629 0x627 0x624 0x615 0x60d 0x612 0x60f 0x60d 0x608 0x60d 0x609 0x605 0x619 0x619 0x622 0x620 0x625 0x627 0x628 0x626 0x625 0x608 0x607 0x60a 0x607 0x606 0x601 0x606 0x603 0x5ff 0x614 0x615 0x61d 0x61c 0x621 0x623 0x624 0x623 0x620 0x60e 0x606 0x609 0x606 0x605 0x602 0x607 0x603 0x5ff 0x60d 0x60e 0x616 0x615 0x619 0x61b 0x61c 0x61c 0x618 0x607 0x5fd 0x600 0x5fd 0x5fd 0x5fa 0x5fe 0x5fa 0x5f5 0x60b 0x60d 0x615 0x613 0x618 0x619 0x61a 0x61a 0x617 0x606 0x5fa 0x5fd 0x5fa 0x5f9 0x5f6 0x5fb 0x5f6 0x5f2 0x607 0x607 0x60e 0x60d 0x612 0x613 0x615 0x616 0x613 0x5fd 0x5f4 0x5f5 0x5f3 0x5f2 0x5ef 0x5f4 0x5ee 0x5eb 0x602 0x604 0x60a 0x608 0x60d 0x60e 0x610 0x611 0x60d 0x5fa 0x5ef 0x5f1 0x5ee 0x5ee 0x5eb 0x5f1 0x5ea 0x5e7 0x5fd 0x5ff 0x605 0x603 0x608 0x60a 0x60b 0x60d 0x609 0x5f3 0x5e9 0x5ea 0x5e7 0x5e8 0x5e4 0x5eb 0x5e4 0x5e1 0x5f4 0x5f6 0x5fb 0x5fa 0x5ff 0x5ff 0x602 0x603 0x5ff 0x5ed 0x5e0 0x5e2 0x5e0 0x5e0 0x5dc 0x5e4 0x5dc 0x5d8 0x5fc 0x5ff 0x602 0x602 0x607 0x607 0x60a 0x60d 0x60e 0x560 0x5d7 0x5d8 0x5d7 0x5d7 0x5d3 0x5db 0x5d1 0x5cf 0x5e1 0x5e5 0x5ef 0x5e9 0x5ee 0x5ed 0x5f2 0x5f4 0x573 0x383 0x5a0 0x5e7 0x5e7 0x5ea 0x5e5 0x5ed 0x5e3 0x5e2 0x5ef 0x5ef 0x5fa 0x5f4 0x5fa 0x5f7 0x5fb 0x5b7 0x398 0x32 0x32 0x32>;
					PS_Config_Lmt_Open_Rawdata_P = <0x781 0xb62 0xbd8 0xbdc 0xbe0 0xbd1 0xbd7 0xb3c 0xffff 0xffff 0xb42 0xbe9 0xbe1 0xbea 0xbf4 0xc07 0xb8f 0x79a 0xb1c 0xbbf 0xbbb 0xbbe 0xbc0 0xbb5 0xbbb 0xba8 0xb53 0xb7c 0xbd2 0xbe6 0xbdf 0xbe5 0xbf2 0xc03 0xc0c 0xb47 0xbed 0xbca 0xbc6 0xbc9 0xbca 0xbc0 0xbc6 0xbb3 0xba3 0xbc6 0xbd3 0xbe8 0xbe2 0xbe8 0xbf7 0xc07 0xc0e 0xc14 0xbd2 0xbce 0xbcd 0xbcf 0xbcf 0xbc5 0xbc9 0xbb5 0xba5 0xbcf 0xbdd 0xbf0 0xbed 0xbf2 0xc00 0xc0e 0xc16 0xc18 0xbda 0xbce 0xbcf 0xbd1 0xbcf 0xbc6 0xbca 0xbb7 0xba7 0xbd7 0xbe4 0xbf3 0xbf2 0xbf8 0xc03 0xc11 0xc1a 0xc1a 0xbdd 0xbdc 0xbdf 0xbdd 0xbdc 0xbd3 0xbd7 0xbc3 0xbb3 0xbda 0xbe6 0xbf4 0xbf3 0xbfb 0xc05 0xc11 0xc1c 0xc19 0xbdd 0xbdc 0xbdc 0xbdc 0xbdb 0xbd2 0xbd4 0xbc0 0xbb6 0xbcf 0xbdf 0xbeb 0xbed 0xbf3 0xbfe 0xc0a 0xc13 0xc0b 0xbea 0xbd7 0xbd8 0xbd6 0xbd7 0xbce 0xbd1 0xbba 0xbb2 0xbe2 0xbf0 0xbf4 0xbef 0xc00 0xc0a 0xc11 0xc1e 0xc15 0xbe9 0xbd3 0xbd6 0xbd3 0xbd4 0xbcd 0xbcf 0xbb9 0xbb2 0xbe9 0xbf5 0xbfd 0xbf7 0xc06 0xc11 0xc1a 0xc21 0xc18 0xbe5 0xbd8 0xbdb 0xbd7 0xbda 0xbd1 0xbd3 0xbbf 0xbb6 0xbe2 0xbef 0xbf7 0xbf2 0xc00 0xc0b 0xc13 0xc19 0xc0c 0xbdf 0xbd8 0xbdc 0xbd7 0xbd7 0xbce 0xbcf 0xbbf 0xbb3 0xbe0 0xbe9 0xbf0 0xbed 0xbfb 0xc05 0xc0c 0xc13 0xc06 0xbe2 0xbce 0xbd3 0xbce 0xbce 0xbc5 0xbc8 0xbb6 0xbad 0xbe0 0xbe8 0xbef 0xbee 0xbfc 0xc02 0xc0a 0xc11 0xc03 0xbe0 0xbcd 0xbd2 0xbcc 0xbce 0xbc5 0xbc6 0xbb6 0xbad 0xbdf 0xbe8 0xbf0 0xbed 0xbf9 0xc01 0xc0a 0xc0c 0xbfd 0xbd3 0xbd3 0xbd7 0xbcf 0xbd1 0xbc8 0xbc9 0xbbe 0xbb1 0xbe5 0xbee 0xbf7 0xbf4 0xc02 0xc07 0xc0f 0xc10 0xc02 0xbd2 0xbc9 0xbd3 0xbca 0xbcd 0xbc3 0xbc8 0xbbe 0xbae 0xbd8 0xbe0 0xbed 0xbe9 0xbf7 0xbfc 0xc05 0xc03 0xbf5 0xbd3 0xbcc 0xbd4 0xbcd 0xbce 0xbc6 0xbce 0xbc4 0xbb3 0xbda 0xbe0 0xbe9 0xbe9 0xbf7 0xbfb 0xc03 0xc00 0xbf0 0xbce 0xbbe 0xbc6 0xbbf 0xbc0 0xbb7 0xbc0 0xbbe 0xba5 0xbce 0xbd4 0xbdd 0xbdf 0xbea 0xbed 0xbf5 0xbf4 0xbe5 0xbcf 0xbb2 0xbbc 0xbb5 0xbb5 0xbac 0xbb3 0xbae 0xb9b 0xbce 0xbd6 0xbdd 0xbdd 0xbe9 0xbea 0xbf4 0xbf0 0xbe6 0xbbf 0xbb7 0xbbc 0xbb6 0xbb6 0xbad 0xbb2 0xbad 0xb95 0xbca 0xbd2 0xbda 0xbda 0xbe4 0xbe6 0xbef 0xbe8 0xbd7 0xbb0 0xbad 0xbb5 0xbad 0xbad 0xba3 0xbab 0xba5 0xb99 0xbc0 0xbc6 0xbd1 0xbcf 0xbd8 0xbda 0xbe4 0xbdc 0xbd1 0xbb5 0xba5 0xbac 0xba4 0xba3 0xb9a 0xba2 0xb9d 0xb91 0xbc5 0xbc9 0xbd4 0xbd2 0xbdc 0xbdc 0xbe5 0xbe1 0xbd3 0xbac 0xba3 0xba9 0xba2 0xba0 0xb99 0xba3 0xb9a 0xb8d 0xbbe 0xbc0 0xbcd 0xbca 0xbd3 0xbd3 0xbdb 0xbd8 0xbca 0xba4 0xb9d 0xba2 0xb9b 0xb99 0xb91 0xb9b 0xb95 0xb87 0xbba 0xbbc 0xbc9 0xbc6 0xbce 0xbcf 0xbd4 0xbcf 0xbc0 0xba2 0xb92 0xb97 0xb90 0xb8f 0xb87 0xb91 0xb8b 0xb7d 0xbae 0xbb5 0xbc0 0xbbe 0xbc5 0xbc4 0xbca 0xbc6 0xbb6 0xa99 0xa7b 0xa83 0xa80 0xa7c 0xa72 0xa78 0xa72 0xa6c 0xa9c 0xa9c 0xaad 0xaaa 0xab3 0xab5 0xab8 0xab4 0xaaf 0xa94 0xa88 0xa8f 0xa8c 0xa88 0xa7f 0xa88 0xa80 0xa78 0xa9c 0xa9c 0xaab 0xaa9 0xab2 0xab4 0xab7 0xab3 0xab0 0xa7f 0xa7c 0xa81 0xa7c 0xa7b 0xa72 0xa7b 0xa76 0xa6e 0xa93 0xa94 0xaa4 0xaa1 0xaaa 0xaae 0xaaf 0xaae 0xaa9 0xa89 0xa7b 0xa80 0xa7b 0xa7a 0xa75 0xa7c 0xa76 0xa6e 0xa86 0xa89 0xa97 0xa94 0xa9c 0xaa0 0xaa1 0xaa1 0xa9b 0xa7e 0xa6c 0xa71 0xa6c 0xa6b 0xa65 0xa6d 0xa65 0xa5e 0xa84 0xa86 0xa94 0xa92 0xa99 0xa9c 0xa9f 0xa9f 0xa98 0xa7b 0xa67 0xa6c 0xa67 0xa64 0xa5f 0xa68 0xa5f 0xa59 0xa7c 0xa7e 0xa89 0xa86 0xa8f 0xa92 0xa96 0xa97 0xa92 0xa6c 0xa5b 0xa5e 0xa5a 0xa59 0xa52 0xa5b 0xa51 0xa4c 0xa75 0xa77 0xa81 0xa7f 0xa86 0xa89 0xa8d 0xa8e 0xa88 0xa65 0xa52 0xa56 0xa51 0xa51 0xa4c 0xa56 0xa4b 0xa46 0xa6c 0xa6e 0xa7a 0xa76 0xa7f 0xa81 0xa84 0xa86 0xa80 0xa5a 0xa48 0xa4b 0xa46 0xa47 0xa3f 0xa4c 0xa3f 0xa3a 0xa5d 0xa5f 0xa68 0xa65 0xa6e 0xa70 0xa73 0xa76 0xa6e 0xa50 0xa39 0xa3d 0xa39 0xa39 0xa33 0xa3f 0xa31 0xa2b 0xa69 0xa6e 0xa75 0xa73 0xa7c 0xa7e 0xa83 0xa86 0xa89 0x959 0xa28 0xa2b 0xa28 0xa28 0xa22 0xa30 0xa20 0xa1a 0xa3c 0xa42 0xa54 0xa48 0xa51 0xa50 0xa57 0xa5d 0x97c 0x61c 0x9c9 0xa46 0xa46 0xa49 0xa42 0xa50 0xa3e 0xa3d 0xa52 0xa52 0xa67 0xa5b 0xa65 0xa62 0xa68 0x9f2 0x641 0x1000 0x1000 0x1000>;
					PS_Config_Lmt_Short_Rawdata_N = <0x2af8 0x2af8 0x2af8 0x2af8 0x2af8 0x2af8 0x2af8 0x2af8 0x2af8 0x2af8 0x2af8 0x2af8 0x2af8 0x2af8 0x2af8 0x2af8 0x2af8 0x2af8 0x2af8 0x2af8 0x2af8 0x2af8 0x2af8 0x2af8 0x2af8 0x2af8 0x2af8 0x2af8 0x2af8 0x2af8 0x2af8 0x2af8 0x2af8 0x2af8 0x2af8 0x2af8 0x2af8 0x2af8 0x2af8 0x2af8 0x2af8 0x2af8 0x2af8 0x2af8 0x2af8 0x2af8 0x2af8 0x2af8 0x2af8 0x2af8 0x2af8 0x2af8 0x2af8 0x2af8 0x2af8 0x2af8 0x2af8 0x2af8 0x2af8 0x2af8 0x2af8 0x2af8 0x2af8 0x2af8 0x2af8 0x2af8 0x2af8 0x2af8 0x2af8 0x2af8 0x2af8 0x2af8 0x2af8 0x2af8 0x2af8 0x2af8 0x2af8 0x2af8 0x2af8 0x2af8 0x2af8 0x2af8 0x2af8 0x2af8 0x2af8 0x2af8 0x2af8 0x2af8 0x2af8 0x2af8 0x2af8 0x2af8 0x2af8 0x2af8 0x2af8 0x2af8 0x2af8 0x2af8 0x2af8 0x2af8 0x2af8 0x2af8 0x2af8 0x2af8 0x2af8 0x2af8 0x2af8 0x2af8 0x2af8 0x2af8 0x2af8 0x2af8 0x2af8 0x2af8 0x2af8 0x2af8 0x2af8 0x2af8 0x2af8 0x2af8 0x2af8 0x2af8 0x2af8 0x2af8 0x2af8 0x2af8 0x2af8 0x2af8 0x2af8 0x2af8 0x2af8 0x2af8 0x2af8 0x2af8 0x2af8 0x2af8 0x2af8 0x2af8 0x2af8 0x2af8 0x2af8 0x2af8 0x2af8 0x2af8 0x2af8 0x2af8 0x2af8 0x2af8 0x2af8 0x2af8 0x2af8 0x2af8 0x2af8 0x2af8 0x2af8 0x2af8 0x2af8 0x2af8 0x2af8 0x2af8 0x2af8 0x2af8 0x2af8 0x2af8 0x2af8 0x2af8 0x2af8 0x2af8 0x2af8 0x2af8 0x2af8 0x2af8 0x2af8 0x2af8 0x2af8 0x2af8 0x2af8 0x2af8 0x2af8 0x2af8 0x2af8 0x2af8 0x2af8 0x2af8 0x2af8 0x2af8 0x2af8 0x2af8 0x2af8 0x2af8 0x2af8 0x2af8 0x2af8 0x2af8 0x2af8 0x2af8 0x2af8 0x2af8 0x2af8 0x2af8 0x2af8 0x2af8 0x2af8 0x2af8 0x2af8 0x2af8 0x2af8 0x2af8 0x2af8 0x2af8 0x2af8 0x2af8 0x2af8 0x2af8 0x2af8 0x2af8 0x2af8 0x2af8 0x2af8 0x2af8 0x2af8 0x2af8 0x2af8 0x2af8 0x2af8 0x2af8 0x2af8 0x2af8 0x2af8 0x2af8 0x2af8 0x2af8 0x2af8 0x2af8 0x2af8 0x2af8 0x2af8 0x2af8 0x2af8 0x2af8 0x2af8 0x2af8 0x2af8 0x2af8 0x2af8 0x2af8 0x2af8 0x2af8 0x2af8 0x2af8 0x2af8 0x2af8 0x2af8 0x2af8 0x2af8 0x2af8 0x2af8 0x2af8 0x2af8 0x2af8 0x2af8 0x2af8 0x2af8 0x2af8 0x2af8 0x2af8 0x2af8 0x2af8 0x2af8 0x2af8 0x2af8 0x2af8 0x2af8 0x2af8 0x2af8 0x2af8 0x2af8 0x2af8 0x2af8 0x2af8 0x2af8 0x2af8 0x2af8 0x2af8 0x2af8 0x2af8 0x2af8 0x2af8 0x2af8 0x2af8 0x2af8 0x2af8 0x2af8 0x2af8 0x2af8 0x2af8 0x2af8 0x2af8 0x2af8 0x2af8 0x2af8 0x2af8 0x2af8 0x2af8 0x2af8 0x2af8 0x2af8 0x2af8 0x2af8 0x2af8 0x2af8 0x2af8 0x2af8 0x2af8 0x2af8 0x2af8 0x2af8 0x2af8 0x2af8 0x2af8 0x2af8 0x2af8 0x2af8 0x2af8 0x2af8 0x2af8 0x2af8 0x2af8 0x2af8 0x2af8 0x2af8 0x2af8 0x2af8 0x2af8 0x2af8 0x2af8 0x2af8 0x2af8 0x2af8 0x2af8 0x2af8 0x2af8 0x2af8 0x2af8 0x2af8 0x2af8 0x2af8 0x2af8 0x2af8 0x2af8 0x2af8 0x2af8 0x2af8 0x2af8 0x2af8 0x2af8 0x2af8 0x2af8 0x2af8 0x2af8 0x2af8 0x2af8 0x2af8 0x2af8 0x2af8 0x2af8 0x2af8 0x2af8 0x2af8 0x2af8 0x2af8 0x2af8 0x2af8 0x2af8 0x2af8 0x2af8 0x2af8 0x2af8 0x2af8 0x2af8 0x2af8 0x2af8 0x2af8 0x2af8 0x2af8 0x2af8 0x2af8 0x2af8 0x2af8 0x2af8 0x2af8 0x2af8 0x2af8 0x2af8 0x2af8 0x2af8 0x2af8 0x2af8 0x2af8 0x2af8 0x2af8 0x2af8 0x2af8 0x2af8 0x2af8 0x2af8 0x2af8 0x2af8 0x2af8 0x2af8 0x2af8 0x2af8 0x2af8 0x2af8 0x2af8 0x2af8 0x2af8 0x2af8 0x2af8 0x2af8 0x2af8 0x2af8 0x2af8 0x2af8 0x2af8 0x2af8 0x2af8 0x2af8 0x2af8 0x2af8 0x2af8 0x2af8 0x2af8 0x2af8 0x2af8 0x2af8 0x2af8 0x2af8 0x2af8 0x2af8 0x2af8 0x2af8 0x2af8 0x2af8 0x2af8 0x2af8 0x2af8 0x2af8 0x2af8 0x2af8 0x2af8 0x2af8 0x2af8 0x2af8 0x2af8 0x2af8 0x2af8 0x2af8 0x2af8 0x2af8 0x2af8 0x2af8 0x2af8 0x2af8 0x2af8 0x2af8 0x2af8 0x2af8 0x2af8 0x2af8 0x2af8 0x2af8 0x2af8 0x2af8 0x2af8 0x2af8 0x2af8 0x2af8 0x2af8 0x2af8 0x2af8 0x2af8 0x2af8 0x2af8 0x2af8 0x2af8 0x2af8 0x2af8 0x2af8 0x2af8 0x2af8 0x2af8 0x2af8 0x2af8 0x2af8 0x2af8 0x2af8 0x2af8 0x2af8 0x2af8 0x2af8 0x2af8 0x2af8 0x2af8 0x2af8 0x2af8 0x2af8 0x2af8 0x2af8 0x2af8 0x2af8 0x2af8 0x2af8 0x2af8 0x2af8 0x2af8 0x2af8 0x2af8 0x2af8 0x2af8 0x2af8 0x2af8 0x2af8 0x2af8 0x2af8 0x2af8 0x2af8 0x2af8 0x2af8 0x2af8 0x2af8 0x2af8 0x2af8 0x2af8 0x2af8 0x2af8 0x2af8 0x2af8 0x2af8 0x2af8 0x2af8 0x2af8 0x2af8 0x2af8 0x2af8 0x2af8 0x2af8 0x2af8 0x2af8 0x2af8 0x2af8 0x2af8 0x2af8 0x2af8 0x2af8 0x2af8 0x2af8 0x2af8 0x2af8 0x2af8 0x2af8 0x2af8 0x2af8 0x2af8 0x2af8 0x2af8 0x2af8 0x2af8 0x2af8 0x2af8 0x2af8 0x2af8 0x2af8 0x2af8 0x2af8 0x2af8 0x2af8 0x2af8 0x2af8 0x2af8 0x2af8 0x2af8 0x2af8 0x2af8 0x2af8 0x2af8 0x2af8 0x2af8 0x2af8 0x2af8 0x2af8 0x2af8 0x2af8 0x2af8 0x2af8 0x2af8 0x2af8 0x2af8 0x2af8 0x2af8 0x2af8 0x2af8 0x2af8 0x2af8 0x2af8 0x2af8 0x2af8 0x2af8 0x2af8 0x2af8 0x2af8 0x2af8 0x2af8 0x2af8 0x2af8 0x2af8 0x2af8 0x2af8 0x2af8 0x2af8 0x2af8 0x2af8 0x2af8 0x2af8 0x2af8 0x2af8 0x2af8 0x2af8 0x2af8 0x2af8 0x2af8 0x2af8 0x2af8 0x2af8 0x2af8 0x2af8 0x2af8 0x2af8 0x2af8 0x2af8 0x2af8 0x2af8 0x2af8 0x2af8 0x2af8 0x2af8 0x2af8 0x2af8 0x2af8 0x2af8 0x2af8>;
					PS_Config_Lmt_Short_Rawdata_P = <0x36b0 0x36b0 0x36b0 0x36b0 0x36b0 0x36b0 0x36b0 0x36b0 0x36b0 0x36b0 0x36b0 0x36b0 0x36b0 0x36b0 0x36b0 0x36b0 0x36b0 0x36b0 0x36b0 0x36b0 0x36b0 0x36b0 0x36b0 0x36b0 0x36b0 0x36b0 0x36b0 0x36b0 0x36b0 0x36b0 0x36b0 0x36b0 0x36b0 0x36b0 0x36b0 0x36b0 0x36b0 0x36b0 0x36b0 0x36b0 0x36b0 0x36b0 0x36b0 0x36b0 0x36b0 0x36b0 0x36b0 0x36b0 0x36b0 0x36b0 0x36b0 0x36b0 0x36b0 0x36b0 0x36b0 0x36b0 0x36b0 0x36b0 0x36b0 0x36b0 0x36b0 0x36b0 0x36b0 0x36b0 0x36b0 0x36b0 0x36b0 0x36b0 0x36b0 0x36b0 0x36b0 0x36b0 0x36b0 0x36b0 0x36b0 0x36b0 0x36b0 0x36b0 0x36b0 0x36b0 0x36b0 0x36b0 0x36b0 0x36b0 0x36b0 0x36b0 0x36b0 0x36b0 0x36b0 0x36b0 0x36b0 0x36b0 0x36b0 0x36b0 0x36b0 0x36b0 0x36b0 0x36b0 0x36b0 0x36b0 0x36b0 0x36b0 0x36b0 0x36b0 0x36b0 0x36b0 0x36b0 0x36b0 0x36b0 0x36b0 0x36b0 0x36b0 0x36b0 0x36b0 0x36b0 0x36b0 0x36b0 0x36b0 0x36b0 0x36b0 0x36b0 0x36b0 0x36b0 0x36b0 0x36b0 0x36b0 0x36b0 0x36b0 0x36b0 0x36b0 0x36b0 0x36b0 0x36b0 0x36b0 0x36b0 0x36b0 0x36b0 0x36b0 0x36b0 0x36b0 0x36b0 0x36b0 0x36b0 0x36b0 0x36b0 0x36b0 0x36b0 0x36b0 0x36b0 0x36b0 0x36b0 0x36b0 0x36b0 0x36b0 0x36b0 0x36b0 0x36b0 0x36b0 0x36b0 0x36b0 0x36b0 0x36b0 0x36b0 0x36b0 0x36b0 0x36b0 0x36b0 0x36b0 0x36b0 0x36b0 0x36b0 0x36b0 0x36b0 0x36b0 0x36b0 0x36b0 0x36b0 0x36b0 0x36b0 0x36b0 0x36b0 0x36b0 0x36b0 0x36b0 0x36b0 0x36b0 0x36b0 0x36b0 0x36b0 0x36b0 0x36b0 0x36b0 0x36b0 0x36b0 0x36b0 0x36b0 0x36b0 0x36b0 0x36b0 0x36b0 0x36b0 0x36b0 0x36b0 0x36b0 0x36b0 0x36b0 0x36b0 0x36b0 0x36b0 0x36b0 0x36b0 0x36b0 0x36b0 0x36b0 0x36b0 0x36b0 0x36b0 0x36b0 0x36b0 0x36b0 0x36b0 0x36b0 0x36b0 0x36b0 0x36b0 0x36b0 0x36b0 0x36b0 0x36b0 0x36b0 0x36b0 0x36b0 0x36b0 0x36b0 0x36b0 0x36b0 0x36b0 0x36b0 0x36b0 0x36b0 0x36b0 0x36b0 0x36b0 0x36b0 0x36b0 0x36b0 0x36b0 0x36b0 0x36b0 0x36b0 0x36b0 0x36b0 0x36b0 0x36b0 0x36b0 0x36b0 0x36b0 0x36b0 0x36b0 0x36b0 0x36b0 0x36b0 0x36b0 0x36b0 0x36b0 0x36b0 0x36b0 0x36b0 0x36b0 0x36b0 0x36b0 0x36b0 0x36b0 0x36b0 0x36b0 0x36b0 0x36b0 0x36b0 0x36b0 0x36b0 0x36b0 0x36b0 0x36b0 0x36b0 0x36b0 0x36b0 0x36b0 0x36b0 0x36b0 0x36b0 0x36b0 0x36b0 0x36b0 0x36b0 0x36b0 0x36b0 0x36b0 0x36b0 0x36b0 0x36b0 0x36b0 0x36b0 0x36b0 0x36b0 0x36b0 0x36b0 0x36b0 0x36b0 0x36b0 0x36b0 0x36b0 0x36b0 0x36b0 0x36b0 0x36b0 0x36b0 0x36b0 0x36b0 0x36b0 0x36b0 0x36b0 0x36b0 0x36b0 0x36b0 0x36b0 0x36b0 0x36b0 0x36b0 0x36b0 0x36b0 0x36b0 0x36b0 0x36b0 0x36b0 0x36b0 0x36b0 0x36b0 0x36b0 0x36b0 0x36b0 0x36b0 0x36b0 0x36b0 0x36b0 0x36b0 0x36b0 0x36b0 0x36b0 0x36b0 0x36b0 0x36b0 0x36b0 0x36b0 0x36b0 0x36b0 0x36b0 0x36b0 0x36b0 0x36b0 0x36b0 0x36b0 0x36b0 0x36b0 0x36b0 0x36b0 0x36b0 0x36b0 0x36b0 0x36b0 0x36b0 0x36b0 0x36b0 0x36b0 0x36b0 0x36b0 0x36b0 0x36b0 0x36b0 0x36b0 0x36b0 0x36b0 0x36b0 0x36b0 0x36b0 0x36b0 0x36b0 0x36b0 0x36b0 0x36b0 0x36b0 0x36b0 0x36b0 0x36b0 0x36b0 0x36b0 0x36b0 0x36b0 0x36b0 0x36b0 0x36b0 0x36b0 0x36b0 0x36b0 0x36b0 0x36b0 0x36b0 0x36b0 0x36b0 0x36b0 0x36b0 0x36b0 0x36b0 0x36b0 0x36b0 0x36b0 0x36b0 0x36b0 0x36b0 0x36b0 0x36b0 0x36b0 0x36b0 0x36b0 0x36b0 0x36b0 0x36b0 0x36b0 0x36b0 0x36b0 0x36b0 0x36b0 0x36b0 0x36b0 0x36b0 0x36b0 0x36b0 0x36b0 0x36b0 0x36b0 0x36b0 0x36b0 0x36b0 0x36b0 0x36b0 0x36b0 0x36b0 0x36b0 0x36b0 0x36b0 0x36b0 0x36b0 0x36b0 0x36b0 0x36b0 0x36b0 0x36b0 0x36b0 0x36b0 0x36b0 0x36b0 0x36b0 0x36b0 0x36b0 0x36b0 0x36b0 0x36b0 0x36b0 0x36b0 0x36b0 0x36b0 0x36b0 0x36b0 0x36b0 0x36b0 0x36b0 0x36b0 0x36b0 0x36b0 0x36b0 0x36b0 0x36b0 0x36b0 0x36b0 0x36b0 0x36b0 0x36b0 0x36b0 0x36b0 0x36b0 0x36b0 0x36b0 0x36b0 0x36b0 0x36b0 0x36b0 0x36b0 0x36b0 0x36b0 0x36b0 0x36b0 0x36b0 0x36b0 0x36b0 0x36b0 0x36b0 0x36b0 0x36b0 0x36b0 0x36b0 0x36b0 0x36b0 0x36b0 0x36b0 0x36b0 0x36b0 0x36b0 0x36b0 0x36b0 0x36b0 0x36b0 0x36b0 0x36b0 0x36b0 0x36b0 0x36b0 0x36b0 0x36b0 0x36b0 0x36b0 0x36b0 0x36b0 0x36b0 0x36b0 0x36b0 0x36b0 0x36b0 0x36b0 0x36b0 0x36b0 0x36b0 0x36b0 0x36b0 0x36b0 0x36b0 0x36b0 0x36b0 0x36b0 0x36b0 0x36b0 0x36b0 0x36b0 0x36b0 0x36b0 0x36b0 0x36b0 0x36b0 0x36b0 0x36b0 0x36b0 0x36b0 0x36b0 0x36b0 0x36b0 0x36b0 0x36b0 0x36b0 0x36b0 0x36b0 0x36b0 0x36b0 0x36b0 0x36b0 0x36b0 0x36b0 0x36b0 0x36b0 0x36b0 0x36b0 0x36b0 0x36b0 0x36b0 0x36b0 0x36b0 0x36b0 0x36b0 0x36b0 0x36b0 0x36b0 0x36b0 0x36b0 0x36b0 0x36b0 0x36b0 0x36b0 0x36b0 0x36b0 0x36b0 0x36b0 0x36b0 0x36b0 0x36b0 0x36b0 0x36b0 0x36b0 0x36b0 0x36b0 0x36b0 0x36b0 0x36b0 0x36b0 0x36b0 0x36b0 0x36b0 0x36b0 0x36b0 0x36b0 0x36b0 0x36b0 0x36b0 0x36b0 0x36b0 0x36b0 0x36b0 0x36b0 0x36b0 0x36b0 0x36b0 0x36b0 0x36b0 0x36b0 0x36b0 0x36b0 0x36b0 0x36b0 0x36b0 0x36b0 0x36b0 0x36b0 0x36b0 0x36b0 0x36b0 0x36b0 0x36b0 0x36b0 0x36b0 0x36b0 0x36b0 0x36b0 0x36b0 0x36b0 0x36b0>;
					X_Channel = <0x12>;
					Y_Channel = <0x24>;
					compatible = "novatek-mp-criteria-591F";
				};
			};
		};
	};

	fragment@65 {
		target = <0xffffffff>;

		__overlay__ {

			ktd@37 {
				compatible = "ktd,ktd3137";
				ktd,bl-channel = <0x2>;
				ktd,bl-fscal-led = <0x98>;
				ktd,i2c-trans-dim = <0x0>;
				ktd,inductor-current = <0xa28>;
				ktd,linear_backlight = <0x1>;
				ktd,linear_ramp = <0x1>;
				ktd,ovp-level = <0x20>;
				ktd,pwm-frequency = <0x64>;
				ktd,pwm-trans-dim = <0x0>;
				ktd,switching-frequency = <0x3e8>;
				ktd,turn-off-ramp = <0x0>;
				ktd,turn-on-ramp = <0x0>;
				ktd,using-lsb = <0x1>;
				reg = <0x37>;
				status = "okay";
			};
		};
	};

	fragment@7 {
		target = <0xffffffff>;

		__overlay__ {
			ac_charger_current = <0x1f47d0>;
			ac_charger_input_current = <0x1f47d0>;
			algorithm_name = "SwitchCharging";
			apple_1_0a_charger_current = <0x9eb10>;
			apple_2_1a_charger_current = <0xc3500>;
			battery_cv = <0x434a90>;
			charging_host_charger_current = <0x16e360>;
			enable_min_charge_temp;
			enable_sw_jeita;
			hvdcp_charger_current = <0x2dc6c0>;
			jeita_temp_above_t4_cv = <0x3f52f0>;
			jeita_temp_below_t0_cv = <0x434a90>;
			jeita_temp_t0_to_t1_cc = <0x61a80>;
			jeita_temp_t0_to_t1_cv = <0x434a90>;
			jeita_temp_t1_to_t1p5_cc = <0xf4240>;
			jeita_temp_t1_to_t1p5_cv = <0x434a90>;
			jeita_temp_t1p5_to_t2_cc = <0x1b7740>;
			jeita_temp_t1p5_to_t2_cv = <0x434a90>;
			jeita_temp_t2_to_t3_cc = <0x2dc6c0>;
			jeita_temp_t2_to_t3_cv = <0x434a90>;
			jeita_temp_t3_to_t4_cc = <0x1b7740>;
			jeita_temp_t3_to_t4_cv = <0x3f52f0>;
			max_charge_temp = <0x3c>;
			max_charge_temp_minus_x_degree = <0x3b>;
			min_charge_temp = <0x0>;
			min_charge_temp_plus_x_degree = <0x2>;
			non_std_ac_charger_current = <0xf4240>;
			pd_vbus_upper_bound = <0x895440>;
			qcom,thermal-mitigation-dcp = <0x1b7740 0x1b7740 0x1b7740 0x1b7740 0x1b7740 0x1b7740 0x1b7740 0x1b7740 0x1b7740 0x1b7740 0x1b7740 0x1b7740 0x186a00 0x155cc0 0x124f80 0xf4240>;
			qcom,thermal-mitigation-pd-base = <0x2dc6c0 0x2ab980 0x27ac40 0x249f00 0x2191c0 0x1e8480 0x1b7740 0x186a00 0x186a00 0x155cc0 0x124f80 0x10c8e0 0xf4240 0xdbba0 0xb7b74 0x802c8>;
			qcom,thermal-mitigation-qc2 = <0x18cba8 0x18cba8 0x18cba8 0x18cba8 0x18cba8 0x174508 0x15be68 0x1437c8 0x12b128 0x112a88 0xfa5dc 0xe1d48 0xc96a8 0xb1008 0x98968 0x802c8>;
			qcom,thermal-mitigation-qc3 = <0x2932e0 0x273710 0x249f00 0x22a330 0x205940 0x1dfbc8 0x1bc560 0x192d50 0x16e360 0x14fb18 0x12b128 0x10c8e0 0xee098 0xc96a8 0xa4cb8 0x73f78>;
			set_cap_delay = <0xa>;
			ta_ac_charger_current = <0x1f47d0>;
			temp_neg_10_thres = <0x0>;
			temp_t0_thres = <0x0>;
			temp_t0_thres_plus_x_degree = <0x0>;
			temp_t1_thres = <0x5>;
			temp_t1_thres_plus_x_degree = <0x6>;
			temp_t1p5_thres = <0xa>;
			temp_t1p5_thres_plus_x_degree = <0xb>;
			temp_t2_thres = <0xf>;
			temp_t2_thres_plus_x_degree = <0x10>;
			temp_t3_thres = <0x2d>;
			temp_t3_thres_minus_x_degree = <0x2b>;
			temp_t4_thres = <0x3c>;
			temp_t4_thres_minus_x_degree = <0x35>;
			usb_charger_current = <0x7a120>;
			usb_charger_current_configured = <0x7a120>;
			usb_charger_current_suspend = <0x0>;
			usb_charger_current_unconfigured = <0x11170>;
		};
	};

	fragment@8 {
		target = <0xffffffff>;

		__overlay__ {
			clock-frequency = <0x61a80>;

			mtk-usb@60 {
				compatible = "mediatek,mtk-usb";
				reg = <0x60>;
				status = "okay";
			};
		};
	};

	fragment@9 {
		target = <0xffffffff>;

		__overlay__ {
			status = "okay";

			spi@1 {
				compatible = "ir,ir_spi";
				phandle = <0x4a>;
				reg = <0x0>;
				spi-cpol;
				spi-max-frequency = <0xf4240>;
			};
		};
	};
};
